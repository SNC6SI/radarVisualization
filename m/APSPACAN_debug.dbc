VERSION ""

NS_ :

BS_:

BU_: PA APS

BO_ 3221225472 VECTOR__INDEPENDENT_SIG_MSG: 0 Vector__XXX
 SG_ VBU_VehicleSysFaultLamp : 0|1@0+ (1,0) [0|1] "" Vector__XXX
 SG_ reserved_0x2B1 : 0|8@0+ (1,0) [0|255] "" Vector__XXX
 SG_ reserved_0x185 : 0|8@0+ (1,0) [0|255] "" Vector__XXX
 SG_ reserved_0x184 : 0|8@0+ (1,0) [0|255] "" Vector__XXX

BO_ 690 APS_0x2B2: 32 APS
 SG_ reserved_0x2B2 : 7|8@0+ (1,0) [0|255] "" Vector__XXX

BO_ 689 APS_0x2B1: 32 APS
 SG_ APS_Debug_PathSeg10KPHeading : 243|12@0+ (0.00154,-3.153) [-3.153|3.1533] "rad" Vector__XXX
 SG_ APS_Debug_PathSeg9KPHeading : 179|12@0+ (0.00154,-3.153) [-3.153|3.1533] "rad" Vector__XXX
 SG_ APS_Debug_PathSeg8KPHeading : 115|12@0+ (0.00154,-3.153) [-3.153|3.1533] "rad" Vector__XXX
 SG_ APS_Debug_PathSeg7KPHeading : 51|12@0+ (0.00154,-3.153) [-3.153|3.1533] "rad" Vector__XXX
 SG_ APS_Debug_PathSeg10KPY : 239|12@0+ (1,-2047) [-2047|2048] "cm" Vector__XXX
 SG_ APS_Debug_PathSeg9KPY : 175|12@0+ (1,-2047) [-2047|2048] "cm" Vector__XXX
 SG_ APS_Debug_PathSeg8KPY : 111|12@0+ (1,-2047) [-2047|2048] "cm" Vector__XXX
 SG_ APS_Debug_PathSeg7KPY : 47|12@0+ (1,-2047) [-2047|2048] "cm" Vector__XXX
 SG_ APS_Debug_PathSeg10KPX : 219|12@0+ (1,-2047) [-2047|2048] "cm" Vector__XXX
 SG_ APS_Debug_PathSeg9KPX : 155|12@0+ (1,-2047) [-2047|2048] "cm" Vector__XXX
 SG_ APS_Debug_PathSeg8KPX : 91|12@0+ (1,-2047) [-2047|2048] "cm" Vector__XXX
 SG_ APS_Debug_PathSeg7KPX : 27|12@0+ (1,-2047) [-2047|2048] "cm" Vector__XXX
 SG_ APS_Debug_PathSeg10CCY : 215|12@0+ (1,-2047) [-2047|2048] "cm" Vector__XXX
 SG_ APS_Debug_PathSeg9CCY : 151|12@0+ (1,-2047) [-2047|2048] "cm" Vector__XXX
 SG_ APS_Debug_PathSeg8CCY : 87|12@0+ (1,-2047) [-2047|2048] "cm" Vector__XXX
 SG_ APS_Debug_PathSeg7CCY : 23|12@0+ (1,-2047) [-2047|2048] "cm" Vector__XXX
 SG_ APS_Debug_PathSeg10CCX : 195|12@0+ (1,-2047) [-2047|2048] "cm" Vector__XXX
 SG_ APS_Debug_PathSeg9CCX : 131|12@0+ (1,-2047) [-2047|2048] "cm" Vector__XXX
 SG_ APS_Debug_PathSeg8CCX : 67|12@0+ (1,-2047) [-2047|2048] "cm" Vector__XXX
 SG_ APS_Debug_PathSeg7CCX : 3|12@0+ (1,-2047) [-2047|2048] "cm" Vector__XXX
 SG_ APS_Debug_PathSeg10Dir : 197|2@0+ (1,0) [0|3] "enum" Vector__XXX
 SG_ APS_Debug_PathSeg9Dir : 133|2@0+ (1,0) [0|3] "enum" Vector__XXX
 SG_ APS_Debug_PathSeg8Dir : 69|2@0+ (1,0) [0|3] "enum" Vector__XXX
 SG_ APS_Debug_PathSeg7Dir : 5|2@0+ (1,0) [0|3] "enum" Vector__XXX
 SG_ APS_Debug_PathSeg10Type : 199|2@0+ (1,0) [0|3] "enum" Vector__XXX
 SG_ APS_Debug_PathSeg9Type : 135|2@0+ (1,0) [0|3] "enum" Vector__XXX
 SG_ APS_Debug_PathSeg8Type : 71|2@0+ (1,0) [0|3] "enum" Vector__XXX
 SG_ APS_Debug_PathSeg7Type : 7|2@0+ (1,0) [0|3] "enum" Vector__XXX

BO_ 389 APS_0x185: 32 APS
 SG_ APS_Debug_PathSeg6KPHeading : 243|12@0+ (0.00154,-3.153) [-3.153|3.1533] "rad" Vector__XXX
 SG_ APS_Debug_PathSeg5KPHeading : 179|12@0+ (0.00154,-3.153) [-3.153|3.1533] "rad" Vector__XXX
 SG_ APS_Debug_PathSeg4KPHeading : 115|12@0+ (0.00154,-3.153) [-3.153|3.1533] "rad" Vector__XXX
 SG_ APS_Debug_PathSeg3KPHeading : 51|12@0+ (0.00154,-3.153) [-3.153|3.1533] "rad" Vector__XXX
 SG_ APS_Debug_PathSeg6KPY : 239|12@0+ (1,-2047) [-2047|2048] "cm" Vector__XXX
 SG_ APS_Debug_PathSeg5KPY : 175|12@0+ (1,-2047) [-2047|2048] "cm" Vector__XXX
 SG_ APS_Debug_PathSeg4KPY : 111|12@0+ (1,-2047) [-2047|2048] "cm" Vector__XXX
 SG_ APS_Debug_PathSeg3KPY : 47|12@0+ (1,-2047) [-2047|2048] "cm" Vector__XXX
 SG_ APS_Debug_PathSeg6KPX : 219|12@0+ (1,-2047) [-2047|2048] "cm" Vector__XXX
 SG_ APS_Debug_PathSeg5KPX : 155|12@0+ (1,-2047) [-2047|2048] "cm" Vector__XXX
 SG_ APS_Debug_PathSeg4KPX : 91|12@0+ (1,-2047) [-2047|2048] "cm" Vector__XXX
 SG_ APS_Debug_PathSeg3KPX : 27|12@0+ (1,-2047) [-2047|2048] "cm" Vector__XXX
 SG_ APS_Debug_PathSeg6CCY : 215|12@0+ (1,-2047) [-2047|2048] "cm" Vector__XXX
 SG_ APS_Debug_PathSeg5CCY : 151|12@0+ (1,-2047) [-2047|2048] "cm" Vector__XXX
 SG_ APS_Debug_PathSeg4CCY : 87|12@0+ (1,-2047) [-2047|2048] "cm" Vector__XXX
 SG_ APS_Debug_PathSeg3CCY : 23|12@0+ (1,-2047) [-2047|2048] "cm" Vector__XXX
 SG_ APS_Debug_PathSeg6CCX : 195|12@0+ (1,-2047) [-2047|2048] "cm" Vector__XXX
 SG_ APS_Debug_PathSeg5CCX : 131|12@0+ (1,-2047) [-2047|2048] "cm" Vector__XXX
 SG_ APS_Debug_PathSeg3CCX : 3|12@0+ (1,-2047) [-2047|2048] "cm" Vector__XXX
 SG_ APS_Debug_PathSeg4CCX : 67|12@0+ (1,-2047) [-2047|2048] "cm" Vector__XXX
 SG_ APS_Debug_PathSeg6Dir : 197|2@0+ (1,0) [0|3] "enum" Vector__XXX
 SG_ APS_Debug_PathSeg5Dir : 133|2@0+ (1,0) [0|3] "enum" Vector__XXX
 SG_ APS_Debug_PathSeg4Dir : 69|2@0+ (1,0) [0|3] "enum" Vector__XXX
 SG_ APS_Debug_PathSeg3Dir : 5|2@0+ (1,0) [0|3] "enum" Vector__XXX
 SG_ APS_Debug_PathSeg6Type : 199|2@0+ (1,0) [0|3] "enum" Vector__XXX
 SG_ APS_Debug_PathSeg5Type : 135|2@0+ (1,0) [0|3] "enum" Vector__XXX
 SG_ APS_Debug_PathSeg4Type : 71|2@0+ (1,0) [0|3] "enum" Vector__XXX
 SG_ APS_Debug_PathSeg3Type : 7|2@0+ (1,0) [0|3] "enum" Vector__XXX

BO_ 388 APS_0x184: 32 APS
 SG_ APS_Debug_PathSeg2KPHeading : 243|12@0+ (0.00154,-3.153) [-3.153|3.1533] "rad" Vector__XXX
 SG_ APS_Debug_PathSeg1KPHeading : 179|12@0+ (0.00154,-3.153) [-3.153|3.1533] "rad" Vector__XXX
 SG_ APS_Debug_PathSeg2KPY : 239|12@0+ (1,-2047) [-2047|2048] "cm" Vector__XXX
 SG_ APS_Debug_PathSeg1KPY : 175|12@0+ (1,-2047) [-2047|2048] "cm" Vector__XXX
 SG_ APS_Debug_PathSeg2KPX : 219|12@0+ (1,-2047) [-2047|2048] "cm" Vector__XXX
 SG_ APS_Debug_PathSeg1KPX : 155|12@0+ (1,-2047) [-2047|2048] "cm" Vector__XXX
 SG_ APS_Debug_PathSeg2CCY : 215|12@0+ (1,-2047) [-2047|2048] "cm" Vector__XXX
 SG_ APS_Debug_PathSeg1CCY : 151|12@0+ (1,-2047) [-2047|2048] "cm" Vector__XXX
 SG_ APS_Debug_PathSeg2CCX : 195|12@0+ (1,-2047) [-2047|2048] "cm" Vector__XXX
 SG_ APS_Debug_PathSeg1CCX : 131|12@0+ (1,-2047) [-2047|2048] "cm" Vector__XXX
 SG_ APS_Debug_PathSeg2Dir : 197|2@0+ (1,0) [0|3] "enum" Vector__XXX
 SG_ APS_Debug_PathSeg1Dir : 133|2@0+ (1,0) [0|3] "enum" Vector__XXX
 SG_ APS_Debug_PathSeg2Type : 199|2@0+ (1,0) [0|3] "enum" Vector__XXX
 SG_ APS_Debug_PathSeg1Type : 135|2@0+ (1,0) [0|3] "enum" Vector__XXX
 SG_ APS_Debug_PathOriginHeading : 103|12@0+ (0.00154,-3.153) [-3.153|3.1533] "rad" Vector__XXX
 SG_ APS_Debug_PathOriginY : 83|12@0+ (1,-2047) [-2047|2048] "cm" Vector__XXX
 SG_ APS_Debug_PathOriginX : 79|12@0+ (1,-2047) [-2047|2048] "cm" Vector__XXX
 SG_ APS_Debug_PathSegNum : 67|4@0+ (1,0) [0|10] "cnt" Vector__XXX
 SG_ APS_Debug_DRHeading : 39|12@0+ (0.00154,-3.153) [-3.153|3.1533] "rad" Vector__XXX
 SG_ APS_Debug_DRY : 19|12@0+ (1,-2047) [-2047|2048] "cm" Vector__XXX
 SG_ APS_Debug_DRX : 15|12@0+ (1,-2047) [-2047|2048] "cm" Vector__XXX
 SG_ APS_Debug_DRVld : 7|1@0+ (1,0) [0|1] "flg" Vector__XXX
 SG_ APS_Debug_PathVld : 71|1@0+ (1,0) [0|1] "flg" Vector__XXX

BO_ 184 APS_EPS_0xB8: 32 APS
 SG_ Checksum_0x175 : 7|8@0+ (1,0) [0|255] ""  PA
 SG_ SAS_SteerWheelAngle : 15|16@0+ (0.0238,-780) [-780|779.733] "deg"  PA
 SG_ SAS_SASStsSnsr : 31|1@0+ (1,0) [0|1] ""  PA
 SG_ SAS_SASStsCal : 47|1@0+ (1,0) [0|1] ""  PA
 SG_ Rolling_counter_0x175 : 59|4@0+ (1,0) [0|15] ""  PA

BO_ 336 APS_ESP_0x150: 32 APS
 SG_ Checksum_0x121 : 7|8@0+ (1,0) [0|255] ""  PA
 SG_ ESP_VehicleSpeed_Valid : 12|1@0+ (1,0) [0|1] ""  PA
 SG_ ESP_VehicleSpeed : 11|12@0+ (0.05625,0) [0|230.2875] "kph"  PA
 SG_ ESP_EPBStatus : 37|3@0+ (1,0) [0|7] ""  PA
 SG_ ESP_VehicleStop : 38|1@0+ (1,0) [0|1] ""  PA
 SG_ ESP_VehicleStop_Valid : 39|1@0+ (1,0) [0|1] ""  PA
 SG_ RollingCounter_0x121 : 59|4@0+ (1,0) [0|15] ""  PA
 SG_ Checksum_0x211 : 71|8@0+ (1,0) [0|255] ""  PA
 SG_ ABS_WheelSpeed_FL : 79|12@0+ (0.05625,0) [0|230.2875] "kph"  PA
 SG_ ABS_WheelSpeed_FR : 83|12@0+ (0.05625,0) [0|230.2875] "kph"  PA
 SG_ ABS_WheelSpeed_RL : 103|12@0+ (0.05625,0) [0|230.2875] "kph"  PA
 SG_ ABS_WheelSpeed_RR : 107|12@0+ (0.05625,0) [0|230.2875] "kph"  PA
 SG_ RollingCounter_0x211 : 123|4@0+ (1,0) [0|15] ""  PA
 SG_ ABS_WheelSpeed_FL_Valid : 124|1@0+ (1,0) [0|1] ""  PA
 SG_ ABS_WheelSpeed_FR_Valid : 125|1@0+ (1,0) [0|1] ""  PA
 SG_ ABS_WheelSpeed_RL_Valid : 126|1@0+ (1,0) [0|1] ""  PA
 SG_ ABS_WheelSpeed_RR_Valid : 127|1@0+ (1,0) [0|1] ""  PA
 SG_ Checksum_0x214 : 135|8@0+ (1,0) [0|255] ""  PA
 SG_ ESP_WheelDirection_FL : 137|2@0+ (1,0) [0|3] ""  PA
 SG_ ESP_WheelDirection_FL_Valid : 138|1@0+ (1,0) [0|1] ""  PA
 SG_ ESP_WheelDirection_FR : 140|2@0+ (1,0) [0|3] ""  PA
 SG_ ESP_WheelDirection_FR_Valid : 141|1@0+ (1,0) [0|1] ""  PA
 SG_ ESP_WheelDirection_RL : 143|2@0+ (1,0) [0|3] ""  PA
 SG_ ESP_WheelDirection_RL_Valid : 144|1@0+ (1,0) [0|1] ""  PA
 SG_ ESP_WheelDirection_RR : 146|2@0+ (1,0) [0|3] ""  PA
 SG_ ESP_WheelDirection_RR_Valid : 147|1@0+ (1,0) [0|1] ""  PA
 SG_ RollingCounter_0x214 : 187|4@0+ (1,0) [0|15] ""  PA
 SG_ Checksum_0x215 : 199|8@0+ (1,0) [0|255] ""  PA
 SG_ ABS_WheelPulse_FL_Valid : 200|1@0+ (1,0) [0|1] ""  PA
 SG_ ABS_WheelPulse_FR_Valid : 201|1@0+ (1,0) [0|1] ""  PA
 SG_ ABS_WheelPulse_RL_Valid : 202|1@0+ (1,0) [0|1] ""  PA
 SG_ ABS_WheelPulse_RR_Valid : 203|1@0+ (1,0) [0|1] ""  PA
 SG_ ABS_WheelPulse_FL : 215|8@0+ (1,0) [0|255] ""  PA
 SG_ ABS_WheelPulse_FR : 223|8@0+ (1,0) [0|255] ""  PA
 SG_ ABS_WheelPulse_RL : 231|8@0+ (1,0) [0|255] ""  PA
 SG_ ABS_WheelPulse_RR : 239|8@0+ (1,0) [0|255] ""  PA
 SG_ RollingCounter_0x215 : 251|4@0+ (1,0) [0|15] ""  PA

BO_ 338 APS_ESP_0x152: 32 APS
 SG_ Checksum1_0x152 : 7|8@0+ (1,0) [0|255] ""  PA
 SG_ ESP_YawrateValue_valid : 12|1@0+ (1,0) [0|1] ""  PA
 SG_ ESP_YawRateValue : 11|12@0+ (0.05,-75) [-75|75] "°/s"  PA
 SG_ ESP_LongAccSensorValid : 28|1@0+ (1,0) [0|1] ""  PA
 SG_ ESP_LongAccSensor : 27|12@0+ (0.01,-20) [-20|20] "m/s^2"  PA
 SG_ ESP_LaterAccSensorValid : 44|1@0+ (1,0) [0|1] ""  PA
 SG_ ESP_LaterAccSensor : 43|12@0+ (0.01,-20) [-20|20] "m/s^2"  PA
 SG_ Rolling_counter1_0x152 : 59|4@0+ (1,0) [0|15] ""  PA
 SG_ Checksum2_0x152 : 71|8@0+ (1,0) [0|255] ""  PA
 SG_ GW_VBU_GearLeverPos : 74|3@0+ (1,0) [0|7] ""  PA
 SG_ GW_VBU_ReadySts : 75|1@0+ (1,0) [0|1] ""  PA
 SG_ GW_BCM_SystemPowerMode : 79|2@0+ (1,0) [0|3] ""  PA
 SG_ GW_AC_OutTemperature : 103|8@0+ (0.5,-40) [-40|80] "℃"  PA
 SG_ Rolling_counter2_0x152 : 123|4@0+ (1,0) [0|15] ""  PA

BO_ 369 APS_0x171: 32 APS
 SG_ Checksum1_0x171 : 7|8@0+ (1,0) [0|255] ""  PA
 SG_ ParkslotI_Selected : 15|8@0+ (1,0) [0|255] ""  PA
 SG_ APS_Workingsts : 23|3@0+ (1,0) [0|7] ""  PA
 SG_ Rolling_counter1_0x171 : 59|4@0+ (1,0) [0|15] ""  PA

BO_ 370 PA_0x172: 32 PA
 SG_ Checksum1_0x172 : 7|8@0+ (1,0) [0|255] ""  APS
 SG_ MapObj01Type : 18|3@0+ (1,0) [0|7] "/"  APS
 SG_ MapObj01Prob : 21|3@0+ (16.666,0) [0|100] "%"  APS
 SG_ MapObj01P1X : 15|10@0+ (4,-2044) [-2044|2048] "cm"  APS
 SG_ MapObj01HeightProb : 37|3@0+ (16.666,0) [0|100] "%"  APS
 SG_ MapObj01P1Y : 31|10@0+ (4,-2044) [-2044|2048] "cm"  APS
 SG_ MapObj01P2X : 33|10@0+ (4,-2044) [-2044|2048] "cm"  APS
 SG_ Rolling_counter1_0x172 : 59|4@0+ (1,0) [0|15] ""  APS
 SG_ MapObj01Height : 61|2@0+ (1,0) [0|3] "/"  APS
 SG_ MapObj01P2Y : 55|10@0+ (4,-2044) [-2044|2048] "cm"  APS
 SG_ Checksum2_0x172 : 71|8@0+ (1,0) [0|255] ""  APS
 SG_ MapObj02Type : 82|3@0+ (1,0) [0|7] "/"  APS
 SG_ MapObj02Prob : 85|3@0+ (16.666,0) [0|100] "%"  APS
 SG_ MapObj02P1X : 79|10@0+ (4,-2044) [-2044|2048] "cm"  APS
 SG_ MapObj02HeightProb : 101|3@0+ (16.666,0) [0|100] "%"  APS
 SG_ MapObj02P1Y : 95|10@0+ (4,-2044) [-2044|2048] "cm"  APS
 SG_ MapObj02P2X : 97|10@0+ (4,-2044) [-2044|2048] "cm"  APS
 SG_ Rolling_counter2_0x172 : 123|4@0+ (1,0) [0|15] ""  APS
 SG_ MapObj02Height : 125|2@0+ (1,0) [0|3] "/"  APS
 SG_ MapObj02P2Y : 119|10@0+ (4,-2044) [-2044|2048] "cm"  APS
 SG_ Checksum3_0x172 : 135|8@0+ (1,0) [0|255] ""  APS
 SG_ MapObj03Type : 146|3@0+ (1,0) [0|7] "/"  APS
 SG_ MapObj03Prob : 149|3@0+ (16.666,0) [0|100] "%"  APS
 SG_ MapObj03P1X : 143|10@0+ (4,-2044) [-2044|2048] "cm"  APS
 SG_ MapObj03HeightProb : 165|3@0+ (16.666,0) [0|100] "%"  APS
 SG_ MapObj03P1Y : 159|10@0+ (4,-2044) [-2044|2048] "cm"  APS
 SG_ MapObj03P2X : 161|10@0+ (4,-2044) [-2044|2048] "cm"  APS
 SG_ Rolling_counter3_0x172 : 187|4@0+ (1,0) [0|15] ""  APS
 SG_ MapObj03Height : 189|2@0+ (1,0) [0|3] "/"  APS
 SG_ MapObj03P2Y : 183|10@0+ (4,-2044) [-2044|2048] "cm"  APS
 SG_ Checksum4_0x172 : 199|8@0+ (1,0) [0|255] ""  APS
 SG_ MapObj04Type : 210|3@0+ (1,0) [0|7] "/"  APS
 SG_ MapObj04Prob : 213|3@0+ (16.666,0) [0|100] "%"  APS
 SG_ MapObj04P1X : 207|10@0+ (4,-2044) [-2044|2048] "cm"  APS
 SG_ MapObj04HeightProb : 229|3@0+ (16.666,0) [0|100] "%"  APS
 SG_ MapObj04P1Y : 223|10@0+ (4,-2044) [-2044|2048] "cm"  APS
 SG_ MapObj04P2X : 225|10@0+ (4,-2044) [-2044|2048] "cm"  APS
 SG_ Rolling_counter4_0x172 : 251|4@0+ (1,0) [0|15] ""  APS
 SG_ MapObj04Height : 253|2@0+ (1,0) [0|3] "/"  APS
 SG_ MapObj04P2Y : 247|10@0+ (4,-2044) [-2044|2048] "cm"  APS

BO_ 371 PA_0x173: 32 PA
 SG_ Checksum1_0x173 : 7|8@0+ (1,0) [0|255] ""  APS
 SG_ MapObj05Type : 18|3@0+ (1,0) [0|7] "/"  APS
 SG_ MapObj05Prob : 21|3@0+ (16.666,0) [0|100] "%"  APS
 SG_ MapObj05P1X : 15|10@0+ (4,-2044) [-2044|2048] "cm"  APS
 SG_ MapObj05HeightProb : 37|3@0+ (16.666,0) [0|100] "%"  APS
 SG_ MapObj05P1Y : 31|10@0+ (4,-2044) [-2044|2048] "cm"  APS
 SG_ MapObj05P2X : 33|10@0+ (4,-2044) [-2044|2048] "cm"  APS
 SG_ Rolling_counter1_0x173 : 59|4@0+ (1,0) [0|15] ""  APS
 SG_ MapObj05Height : 61|2@0+ (1,0) [0|3] "/"  APS
 SG_ MapObj05P2Y : 55|10@0+ (4,-2044) [-2044|2048] "cm"  APS
 SG_ Checksum2_0x173 : 71|8@0+ (1,0) [0|255] ""  APS
 SG_ MapObj06Type : 82|3@0+ (1,0) [0|7] "/"  APS
 SG_ MapObj06Prob : 85|3@0+ (16.666,0) [0|100] "%"  APS
 SG_ MapObj06P1X : 79|10@0+ (4,-2044) [-2044|2048] "cm"  APS
 SG_ MapObj06HeightProb : 101|3@0+ (16.666,0) [0|100] "%"  APS
 SG_ MapObj06P1Y : 95|10@0+ (4,-2044) [-2044|2048] "cm"  APS
 SG_ MapObj06P2X : 97|10@0+ (4,-2044) [-2044|2048] "cm"  APS
 SG_ Rolling_counter2_0x173 : 123|4@0+ (1,0) [0|15] ""  APS
 SG_ MapObj06Height : 125|2@0+ (1,0) [0|3] "/"  APS
 SG_ MapObj06P2Y : 119|10@0+ (4,-2044) [-2044|2048] "cm"  APS
 SG_ Checksum3_0x173 : 135|8@0+ (1,0) [0|255] ""  APS
 SG_ MapObj07Type : 146|3@0+ (1,0) [0|7] "/"  APS
 SG_ MapObj07Prob : 149|3@0+ (16.666,0) [0|100] "%"  APS
 SG_ MapObj07P1X : 143|10@0+ (4,-2044) [-2044|2048] "cm"  APS
 SG_ MapObj07HeightProb : 165|3@0+ (16.666,0) [0|100] "%"  APS
 SG_ MapObj07P1Y : 159|10@0+ (4,-2044) [-2044|2048] "cm"  APS
 SG_ MapObj07P2X : 161|10@0+ (4,-2044) [-2044|2048] "cm"  APS
 SG_ Rolling_counter3_0x173 : 187|4@0+ (1,0) [0|15] ""  APS
 SG_ MapObj07Height : 189|2@0+ (1,0) [0|3] "/"  APS
 SG_ MapObj07P2Y : 183|10@0+ (4,-2044) [-2044|2048] "cm"  APS
 SG_ Checksum4_0x173 : 199|8@0+ (1,0) [0|255] ""  APS
 SG_ MapObj08Type : 210|3@0+ (1,0) [0|7] "/"  APS
 SG_ MapObj08Prob : 213|3@0+ (16.666,0) [0|100] "%"  APS
 SG_ MapObj08P1X : 207|10@0+ (4,-2044) [-2044|2048] "cm"  APS
 SG_ MapObj08HeightProb : 229|3@0+ (16.666,0) [0|100] "%"  APS
 SG_ MapObj08P1Y : 223|10@0+ (4,-2044) [-2044|2048] "cm"  APS
 SG_ MapObj08P2X : 225|10@0+ (4,-2044) [-2044|2048] "cm"  APS
 SG_ Rolling_counter4_0x173 : 251|4@0+ (1,0) [0|15] ""  APS
 SG_ MapObj08Height : 253|2@0+ (1,0) [0|3] "/"  APS
 SG_ MapObj08P2Y : 247|10@0+ (4,-2044) [-2044|2048] "cm"  APS

BO_ 372 PA_0x174: 32 PA
 SG_ Checksum1_0x174 : 7|8@0+ (1,0) [0|255] ""  APS
 SG_ MapObj09Type : 18|3@0+ (1,0) [0|7] "/"  APS
 SG_ MapObj09Prob : 21|3@0+ (16.666,0) [0|100] "%"  APS
 SG_ MapObj09P1X : 15|10@0+ (4,-2044) [-2044|2048] "cm"  APS
 SG_ MapObj09HeightProb : 37|3@0+ (16.666,0) [0|100] "%"  APS
 SG_ MapObj09P1Y : 31|10@0+ (4,-2044) [-2044|2048] "cm"  APS
 SG_ MapObj09P2X : 33|10@0+ (4,-2044) [-2044|2048] "cm"  APS
 SG_ Rolling_counter1_0x174 : 59|4@0+ (1,0) [0|15] ""  APS
 SG_ MapObj09Height : 61|2@0+ (1,0) [0|3] "/"  APS
 SG_ MapObj09P2Y : 55|10@0+ (4,-2044) [-2044|2048] "cm"  APS
 SG_ Checksum2_0x174 : 71|8@0+ (1,0) [0|255] ""  APS
 SG_ MapObj10Type : 82|3@0+ (1,0) [0|7] "/"  APS
 SG_ MapObj10Prob : 85|3@0+ (16.666,0) [0|100] "%"  APS
 SG_ MapObj10P1X : 79|10@0+ (4,-2044) [-2044|2048] "cm"  APS
 SG_ MapObj10HeightProb : 101|3@0+ (16.666,0) [0|100] "%"  APS
 SG_ MapObj10P1Y : 95|10@0+ (4,-2044) [-2044|2048] "cm"  APS
 SG_ MapObj10P2X : 97|10@0+ (4,-2044) [-2044|2048] "cm"  APS
 SG_ Rolling_counter2_0x174 : 123|4@0+ (1,0) [0|15] ""  APS
 SG_ MapObj10Height : 125|2@0+ (1,0) [0|3] "/"  APS
 SG_ MapObj10P2Y : 119|10@0+ (4,-2044) [-2044|2048] "cm"  APS
 SG_ Checksum3_0x174 : 135|8@0+ (1,0) [0|255] ""  APS
 SG_ MapObj11Type : 146|3@0+ (1,0) [0|7] "/"  APS
 SG_ MapObj11Prob : 149|3@0+ (16.666,0) [0|100] "%"  APS
 SG_ MapObj11P1X : 143|10@0+ (4,-2044) [-2044|2048] "cm"  APS
 SG_ MapObj11HeightProb : 165|3@0+ (16.666,0) [0|100] "%"  APS
 SG_ MapObj11P1Y : 159|10@0+ (4,-2044) [-2044|2048] "cm"  APS
 SG_ MapObj11P2X : 161|10@0+ (4,-2044) [-2044|2048] "cm"  APS
 SG_ Rolling_counter3_0x174 : 187|4@0+ (1,0) [0|15] ""  APS
 SG_ MapObj11Height : 189|2@0+ (1,0) [0|3] "/"  APS
 SG_ MapObj11P2Y : 183|10@0+ (4,-2044) [-2044|2048] "cm"  APS
 SG_ Checksum4_0x174 : 199|8@0+ (1,0) [0|255] ""  APS
 SG_ MapObj12Type : 210|3@0+ (1,0) [0|7] "/"  APS
 SG_ MapObj12Prob : 213|3@0+ (16.666,0) [0|100] "%"  APS
 SG_ MapObj12P1X : 207|10@0+ (4,-2044) [-2044|2048] "cm"  APS
 SG_ MapObj12HeightProb : 229|3@0+ (16.666,0) [0|100] "%"  APS
 SG_ MapObj12P1Y : 223|10@0+ (4,-2044) [-2044|2048] "cm"  APS
 SG_ MapObj12P2X : 225|10@0+ (4,-2044) [-2044|2048] "cm"  APS
 SG_ Rolling_counter4_0x174 : 251|4@0+ (1,0) [0|15] ""  APS
 SG_ MapObj12Height : 253|2@0+ (1,0) [0|3] "/"  APS
 SG_ MapObj12P2Y : 247|10@0+ (4,-2044) [-2044|2048] "cm"  APS

BO_ 375 PA_0x177: 32 PA
 SG_ Checksum1_0x177 : 7|8@0+ (1,0) [0|255] ""  APS
 SG_ MapObj13Type : 18|3@0+ (1,0) [0|7] "/"  APS
 SG_ MapObj13Prob : 21|3@0+ (16.666,0) [0|100] "%"  APS
 SG_ MapObj13P1X : 15|10@0+ (4,-2044) [-2044|2048] "cm"  APS
 SG_ MapObj13HeightProb : 37|3@0+ (16.666,0) [0|100] "%"  APS
 SG_ MapObj13P1Y : 31|10@0+ (4,-2044) [-2044|2048] "cm"  APS
 SG_ MapObj13P2X : 33|10@0+ (4,-2044) [-2044|2048] "cm"  APS
 SG_ Rolling_counter1_0x177 : 59|4@0+ (1,0) [0|15] ""  APS
 SG_ MapObj13Height : 61|2@0+ (1,0) [0|3] "/"  APS
 SG_ MapObj13P2Y : 55|10@0+ (4,-2044) [-2044|2048] "cm"  APS
 SG_ Checksum2_0x177 : 71|8@0+ (1,0) [0|255] ""  APS
 SG_ MapObj14Type : 82|3@0+ (1,0) [0|7] "/"  APS
 SG_ MapObj14Prob : 85|3@0+ (16.666,0) [0|100] "%"  APS
 SG_ MapObj14P1X : 79|10@0+ (4,-2044) [-2044|2048] "cm"  APS
 SG_ MapObj14HeightProb : 101|3@0+ (16.666,0) [0|100] "%"  APS
 SG_ MapObj14P1Y : 95|10@0+ (4,-2044) [-2044|2048] "cm"  APS
 SG_ MapObj14P2X : 97|10@0+ (4,-2044) [-2044|2048] "cm"  APS
 SG_ Rolling_counter2_0x177 : 123|4@0+ (1,0) [0|15] ""  APS
 SG_ MapObj14Height : 125|2@0+ (1,0) [0|3] "/"  APS
 SG_ MapObj14P2Y : 119|10@0+ (4,-2044) [-2044|2048] "cm"  APS
 SG_ Checksum3_0x177 : 135|8@0+ (1,0) [0|255] ""  APS
 SG_ MapObj15Type : 146|3@0+ (1,0) [0|7] "/"  APS
 SG_ MapObj15Prob : 149|3@0+ (16.666,0) [0|100] "%"  APS
 SG_ MapObj15P1X : 143|10@0+ (4,-2044) [-2044|2048] "cm"  APS
 SG_ MapObj15HeightProb : 165|3@0+ (16.666,0) [0|100] "%"  APS
 SG_ MapObj15P1Y : 159|10@0+ (4,-2044) [-2044|2048] "cm"  APS
 SG_ MapObj15P2X : 161|10@0+ (4,-2044) [-2044|2048] "cm"  APS
 SG_ Rolling_counter3_0x177 : 187|4@0+ (1,0) [0|15] ""  APS
 SG_ MapObj15Height : 189|2@0+ (1,0) [0|3] "/"  APS
 SG_ MapObj15P2Y : 183|10@0+ (4,-2044) [-2044|2048] "cm"  APS
 SG_ Checksum4_0x177 : 199|8@0+ (1,0) [0|255] ""  APS
 SG_ MapObj16Type : 210|3@0+ (1,0) [0|7] "/"  APS
 SG_ MapObj16Prob : 213|3@0+ (16.666,0) [0|100] "%"  APS
 SG_ MapObj16P1X : 207|10@0+ (4,-2044) [-2044|2048] "cm"  APS
 SG_ MapObj16HeightProb : 229|3@0+ (16.666,0) [0|100] "%"  APS
 SG_ MapObj16P1Y : 223|10@0+ (4,-2044) [-2044|2048] "cm"  APS
 SG_ MapObj16P2X : 225|10@0+ (4,-2044) [-2044|2048] "cm"  APS
 SG_ Rolling_counter4_0x177 : 251|4@0+ (1,0) [0|15] ""  APS
 SG_ MapObj16Height : 253|2@0+ (1,0) [0|3] "/"  APS
 SG_ MapObj16P2Y : 247|10@0+ (4,-2044) [-2044|2048] "cm"  APS

BO_ 376 PA_0x178: 32 PA
 SG_ Checksum1_0x178 : 7|8@0+ (1,0) [0|255] ""  APS
 SG_ MapObj17Type : 18|3@0+ (1,0) [0|7] "/"  APS
 SG_ MapObj17Prob : 21|3@0+ (16.666,0) [0|100] "%"  APS
 SG_ MapObj17P1X : 15|10@0+ (4,-2044) [-2044|2048] "cm"  APS
 SG_ MapObj17HeightProb : 37|3@0+ (16.666,0) [0|100] "%"  APS
 SG_ MapObj17P1Y : 31|10@0+ (4,-2044) [-2044|2048] "cm"  APS
 SG_ MapObj17P2X : 33|10@0+ (4,-2044) [-2044|2048] "cm"  APS
 SG_ Rolling_counter1_0x178 : 59|4@0+ (1,0) [0|15] ""  APS
 SG_ MapObj17Height : 61|2@0+ (1,0) [0|3] "/"  APS
 SG_ MapObj17P2Y : 55|10@0+ (4,-2044) [-2044|2048] "cm"  APS
 SG_ Checksum2_0x178 : 71|8@0+ (1,0) [0|255] ""  APS
 SG_ MapObj18Type : 82|3@0+ (1,0) [0|7] "/"  APS
 SG_ MapObj18Prob : 85|3@0+ (16.666,0) [0|100] "%"  APS
 SG_ MapObj18P1X : 79|10@0+ (4,-2044) [-2044|2048] "cm"  APS
 SG_ MapObj18HeightProb : 101|3@0+ (16.666,0) [0|100] "%"  APS
 SG_ MapObj18P1Y : 95|10@0+ (4,-2044) [-2044|2048] "cm"  APS
 SG_ MapObj18P2X : 97|10@0+ (4,-2044) [-2044|2048] "cm"  APS
 SG_ Rolling_counter2_0x178 : 123|4@0+ (1,0) [0|15] ""  APS
 SG_ MapObj18Height : 125|2@0+ (1,0) [0|3] "/"  APS
 SG_ MapObj18P2Y : 119|10@0+ (4,-2044) [-2044|2048] "cm"  APS
 SG_ Checksum3_0x178 : 135|8@0+ (1,0) [0|255] ""  APS
 SG_ MapObj19Type : 146|3@0+ (1,0) [0|7] "/"  APS
 SG_ MapObj19Prob : 149|3@0+ (16.666,0) [0|100] "%"  APS
 SG_ MapObj19P1X : 143|10@0+ (4,-2044) [-2044|2048] "cm"  APS
 SG_ MapObj19HeightProb : 165|3@0+ (16.666,0) [0|100] "%"  APS
 SG_ MapObj19P1Y : 159|10@0+ (4,-2044) [-2044|2048] "cm"  APS
 SG_ MapObj19P2X : 161|10@0+ (4,-2044) [-2044|2048] "cm"  APS
 SG_ Rolling_counter3_0x178 : 187|4@0+ (1,0) [0|15] ""  APS
 SG_ MapObj19Height : 189|2@0+ (1,0) [0|3] "/"  APS
 SG_ MapObj19P2Y : 183|10@0+ (4,-2044) [-2044|2048] "cm"  APS
 SG_ Checksum4_0x178 : 199|8@0+ (1,0) [0|255] ""  APS
 SG_ MapObj20Type : 210|3@0+ (1,0) [0|7] "/"  APS
 SG_ MapObj20Prob : 213|3@0+ (16.666,0) [0|100] "%"  APS
 SG_ MapObj20P1X : 207|10@0+ (4,-2044) [-2044|2048] "cm"  APS
 SG_ MapObj20HeightProb : 229|3@0+ (16.666,0) [0|100] "%"  APS
 SG_ MapObj20P1Y : 223|10@0+ (4,-2044) [-2044|2048] "cm"  APS
 SG_ MapObj20P2X : 225|10@0+ (4,-2044) [-2044|2048] "cm"  APS
 SG_ Rolling_counter4_0x178 : 251|4@0+ (1,0) [0|15] ""  APS
 SG_ MapObj20Height : 253|2@0+ (1,0) [0|3] "/"  APS
 SG_ MapObj20P2Y : 247|10@0+ (4,-2044) [-2044|2048] "cm"  APS

BO_ 377 PA_0x179: 32 PA
 SG_ Checksum1_0x179 : 7|8@0+ (1,0) [0|255] ""  APS
 SG_ ParkLeftslot0ID : 15|8@0+ (1,0) [0|255] ""  APS
 SG_ ApaPscLeftSlot0Obj1X : 23|11@0+ (2,-3584) [-3584|510] "CM"  APS
 SG_ ApaPscLeftSlot0Obj1Y : 28|11@0+ (2,-3584) [-3584|510] "CM"  APS
 SG_ ApaPscLeftSlot0Obj2X : 33|11@0+ (2,-3584) [-3584|510] "CM"  APS
 SG_ Rolling_counter1_0x179 : 59|4@0+ (1,0) [0|15] ""  APS
 SG_ ApaPscLeftSlot0Obj2Y : 54|11@0+ (2,-3584) [-3584|510] "CM"  APS
 SG_ Checksum2_0x179 : 71|8@0+ (1,0) [0|255] ""  APS
 SG_ ApaPscLeftSlot0Obj1Alpha : 79|7@0+ (2,-128) [-128|126] "°"  APS
 SG_ ApaPscLeftSlot0Obj2Alpha : 87|7@0+ (2,-128) [-128|126] "°"  APS
 SG_ ApaPsc_LeftPSL0_Depth : 95|8@0+ (4,0) [0|1020] "CM"  APS
 SG_ ApaPscLeftSlot0Tpye : 110|3@0+ (1,0) [0|7] ""  APS
 SG_ ApaPsc_LeftPSL0_Length : 103|9@0+ (4,0) [0|2044] "CM"  APS
 SG_ ApaPsc_LeftPSL0_ObjectType : 119|3@0+ (1,0) [0|7] ""  APS
 SG_ Rolling_counter2_0x179 : 123|4@0+ (1,0) [0|15] ""  APS
 SG_ Checksum3_0x179 : 135|8@0+ (1,0) [0|255] ""  APS
 SG_ ParkLeftslot1ID : 143|8@0+ (1,0) [0|255] ""  APS
 SG_ ApaPscLeftSlot1Obj1X : 151|11@0+ (2,-3584) [-3584|510] "CM"  APS
 SG_ ApaPscLeftSlot1Obj1Y : 156|11@0+ (2,-3584) [-3584|510] "CM"  APS
 SG_ ApaPscLeftSlot1Obj2X : 161|11@0+ (2,-3584) [-3584|510] "CM"  APS
 SG_ Rolling_counter3_0x179 : 187|4@0+ (1,0) [0|15] ""  APS
 SG_ ApaPscLeftSlot1Obj2Y : 182|11@0+ (2,-3584) [-3584|510] "CM"  APS
 SG_ Checksum4_0x179 : 199|8@0+ (1,0) [0|255] ""  APS
 SG_ ApaPscLeftSlot1Obj1Alpha : 207|7@0+ (2,-128) [-128|126] "°"  APS
 SG_ ApaPscLeftSlot1Obj2Alpha : 215|7@0+ (2,-128) [-128|126] "°"  APS
 SG_ ApaPsc_LeftPSL1_Depth : 223|8@0+ (4,0) [0|1020] "CM"  APS
 SG_ ApaPscLeftSlot1Tpye : 238|3@0+ (1,0) [0|7] ""  APS
 SG_ ApaPsc_LeftPSL1_Length : 231|9@0+ (4,0) [0|2044] "CM"  APS
 SG_ ApaPsc_LeftPSL1_ObjectType : 247|3@0+ (1,0) [0|7] ""  APS
 SG_ Rolling_counter4_0x179 : 251|4@0+ (1,0) [0|15] ""  APS

BO_ 378 PA_0x17A: 32 PA
 SG_ Checksum1_0x17A : 7|8@0+ (1,0) [0|255] ""  APS
 SG_ ParkRightslot0ID : 15|8@0+ (1,0) [0|255] ""  APS
 SG_ ApaPscRightSlot0Obj1X : 23|11@0+ (2,-3584) [-3584|510] "CM"  APS
 SG_ ApaPscRightSlot0Obj1Y : 28|11@0+ (2,-3584) [-3584|510] "CM"  APS
 SG_ ApaPscRightSlot0Obj2X : 33|11@0+ (2,-3584) [-3584|510] "CM"  APS
 SG_ Rolling_counter1_0x17A : 59|4@0+ (1,0) [0|15] ""  APS
 SG_ ApaPscRightSlot0Obj2Y : 54|11@0+ (2,-3584) [-3584|510] "CM"  APS
 SG_ Checksum2_0x17A : 71|8@0+ (1,0) [0|255] ""  APS
 SG_ ApaPscRightSlot0Obj1Alpha : 79|7@0+ (2,-128) [-128|126] "°"  APS
 SG_ ApaPscRightSlot0Obj2Alpha : 87|7@0+ (2,-128) [-128|126] "°"  APS
 SG_ ApaPsc_RightPSL0_Depth : 95|8@0+ (4,0) [0|1020] "CM"  APS
 SG_ ApaPscRightSlot0Tpye : 110|3@0+ (1,0) [0|7] ""  APS
 SG_ ApaPsc_RightPSL0_Length : 103|9@0+ (4,0) [0|2044] "CM"  APS
 SG_ ApaPsc_RightPSL0_ObjectType : 119|3@0+ (1,0) [0|7] ""  APS
 SG_ Rolling_counter2_0x17A : 123|4@0+ (1,0) [0|15] ""  APS
 SG_ Checksum3_0x17A : 135|8@0+ (1,0) [0|255] ""  APS
 SG_ ParkRightslot1ID : 143|8@0+ (1,0) [0|255] ""  APS
 SG_ ApaPscRightSlot1Obj1X : 151|11@0+ (2,-3584) [-3584|510] "CM"  APS
 SG_ ApaPscRightSlot1Obj1Y : 156|11@0+ (2,-3584) [-3584|510] "CM"  APS
 SG_ ApaPscRightSlot1Obj2X : 161|11@0+ (2,-3584) [-3584|510] "CM"  APS
 SG_ Rolling_counter3_0x17A : 187|4@0+ (1,0) [0|15] ""  APS
 SG_ ApaPscRightSlot1Obj2Y : 182|11@0+ (2,-3584) [-3584|510] "CM"  APS
 SG_ Checksum4_0x17A : 199|8@0+ (1,0) [0|255] ""  APS
 SG_ ApaPscRightSlot1Obj1Alpha : 207|7@0+ (2,-128) [-128|126] "°"  APS
 SG_ ApaPscRightSlot1Obj2Alpha : 215|7@0+ (2,-128) [-128|126] "°"  APS
 SG_ ApaPsc_RightPSL1_Depth : 223|8@0+ (4,0) [0|1020] "CM"  APS
 SG_ ApaPscRightSlot1Tpye : 238|3@0+ (1,0) [0|7] ""  APS
 SG_ ApaPsc_RightPSL1_Length : 231|9@0+ (4,0) [0|2044] "CM"  APS
 SG_ ApaPsc_RightPSL1_ObjectType : 247|3@0+ (1,0) [0|7] ""  APS
 SG_ Rolling_counter4_0x17A : 251|4@0+ (1,0) [0|15] ""  APS

BO_ 379 PA_0x17B: 32 PA
 SG_ Checksum1_0x17B : 7|8@0+ (1,0) [0|255] ""  APS
 SG_ USS_DE1_2 : 15|10@0+ (1,0) [0|1023] "cm"  APS
 SG_ USS_DE1_3 : 17|10@0+ (1,0) [0|1023] "cm"  APS
 SG_ USS_DE1_4 : 39|10@0+ (1,0) [0|1023] "cm"  APS
 SG_ USS_DE1_5 : 41|10@0+ (1,0) [0|1023] "cm"  APS
 SG_ Rolling_counter1_0x17B : 59|4@0+ (1,0) [0|15] ""  APS
 SG_ Checksum2_0x17B : 71|8@0+ (1,0) [0|255] ""  APS
 SG_ USS_DE1_8 : 79|10@0+ (1,0) [0|1023] "cm"  APS
 SG_ USS_DE1_9 : 81|10@0+ (1,0) [0|1023] "cm"  APS
 SG_ USS_DE1_10 : 103|10@0+ (1,0) [0|1023] "cm"  APS
 SG_ USS_DE1_11 : 105|10@0+ (1,0) [0|1023] "cm"  APS
 SG_ Rolling_counter2_0x17B : 123|4@0+ (1,0) [0|15] ""  APS
 SG_ Checksum3_0x17B : 135|8@0+ (1,0) [0|255] ""  APS
 SG_ USS_DE1_1 : 143|10@0+ (1,0) [0|1023] "cm"  APS
 SG_ USS_DE1_6 : 145|10@0+ (1,0) [0|1023] "cm"  APS
 SG_ USS_DE1_7 : 167|10@0+ (1,0) [0|1023] "cm"  APS
 SG_ USS_DE1_12 : 169|10@0+ (1,0) [0|1023] "cm"  APS
 SG_ Rolling_counter3_0x17B : 187|4@0+ (1,0) [0|15] ""  APS

BO_ 380 PA_0x17C: 32 PA
 SG_ Checksum1_0x17C : 7|8@0+ (1,0) [0|255] ""  APS
 SG_ USS_CE1_1_right : 15|10@0+ (1,0) [0|1023] "cm"  APS
 SG_ USS_CE1_2_right : 21|10@0+ (1,0) [0|1023] "cm"  APS
 SG_ USS_CE1_3_right : 27|10@0+ (1,0) [0|1023] "cm"  APS
 SG_ USS_CE1_4_right : 33|10@0+ (1,0) [0|1023] "cm"  APS
 SG_ Rolling_counter1_0x17C : 59|4@0+ (1,0) [0|15] ""  APS
 SG_ USS_CE1_5_right : 55|10@0+ (1,0) [0|1023] "cm"  APS
 SG_ Checksum2_0x17C : 71|8@0+ (1,0) [0|255] ""  APS
 SG_ USS_CE1_7_right : 79|10@0+ (1,0) [0|1023] "cm"  APS
 SG_ USS_CE1_8_right : 85|10@0+ (1,0) [0|1023] "cm"  APS
 SG_ USS_CE1_9_right : 91|10@0+ (1,0) [0|1023] "cm"  APS
 SG_ USS_CE1_10_right : 97|10@0+ (1,0) [0|1023] "cm"  APS
 SG_ Rolling_counter2_0x17C : 123|4@0+ (1,0) [0|15] ""  APS
 SG_ USS_CE1_11_right : 119|10@0+ (1,0) [0|1023] "cm"  APS
 SG_ Checksum3_0x17C : 135|8@0+ (1,0) [0|255] ""  APS
 SG_ USS_CE1_2_left : 143|10@0+ (1,0) [0|1023] "cm"  APS
 SG_ USS_CE1_3_left : 149|10@0+ (1,0) [0|1023] "cm"  APS
 SG_ USS_CE1_4_left : 155|10@0+ (1,0) [0|1023] "cm"  APS
 SG_ USS_CE1_5_left : 161|10@0+ (1,0) [0|1023] "cm"  APS
 SG_ Rolling_counter3_0x17C : 187|4@0+ (1,0) [0|15] ""  APS
 SG_ USS_CE1_6_left : 183|10@0+ (1,0) [0|1023] "cm"  APS
 SG_ Checksum4_0x17C : 199|8@0+ (1,0) [0|255] ""  APS
 SG_ USS_CE1_8_left : 207|10@0+ (1,0) [0|1023] "cm"  APS
 SG_ USS_CE1_9_left : 213|10@0+ (1,0) [0|1023] "cm"  APS
 SG_ USS_CE1_10_left : 219|10@0+ (1,0) [0|1023] "cm"  APS
 SG_ USS_CE1_11_left : 225|10@0+ (1,0) [0|1023] "cm"  APS
 SG_ Rolling_counter4_0x17C : 251|4@0+ (1,0) [0|15] ""  APS
 SG_ USS_CE1_12_left : 247|10@0+ (1,0) [0|1023] "cm"  APS

BO_ 381 PA_0x17D: 32 PA
 SG_ Checksum1_0x17D : 7|8@0+ (1,0) [0|255] ""  APS
 SG_ USS_DE2_2 : 15|10@0+ (1,0) [0|1023] "cm"  APS
 SG_ USS_DE2_3 : 17|10@0+ (1,0) [0|1023] "cm"  APS
 SG_ USS_DE2_4 : 39|10@0+ (1,0) [0|1023] "cm"  APS
 SG_ USS_DE2_5 : 41|10@0+ (1,0) [0|1023] "cm"  APS
 SG_ Rolling_counter1_0x17D : 59|4@0+ (1,0) [0|15] ""  APS
 SG_ Checksum2_0x17D : 71|8@0+ (1,0) [0|255] ""  APS
 SG_ USS_DE2_8 : 79|10@0+ (1,0) [0|1023] "cm"  APS
 SG_ USS_DE2_9 : 81|10@0+ (1,0) [0|1023] "cm"  APS
 SG_ USS_DE2_10 : 103|10@0+ (1,0) [0|1023] "cm"  APS
 SG_ USS_DE2_11 : 105|10@0+ (1,0) [0|1023] "cm"  APS
 SG_ Rolling_counter2_0x17D : 123|4@0+ (1,0) [0|15] ""  APS
 SG_ Checksum3_0x17D : 135|8@0+ (1,0) [0|255] ""  APS
 SG_ USS_DE2_1 : 143|10@0+ (1,0) [0|1023] "cm"  APS
 SG_ USS_DE2_6 : 145|10@0+ (1,0) [0|1023] "cm"  APS
 SG_ USS_DE2_7 : 167|10@0+ (1,0) [0|1023] "cm"  APS
 SG_ USS_DE2_12 : 169|10@0+ (1,0) [0|1023] "cm"  APS
 SG_ Rolling_counter3_0x17D : 187|4@0+ (1,0) [0|15] ""  APS

BO_ 382 PA_0x17E: 32 PA
 SG_ Checksum1_0x17E : 7|8@0+ (1,0) [0|255] ""  APS
 SG_ USS_CE2_1_right : 15|10@0+ (1,0) [0|1023] "cm"  APS
 SG_ USS_CE2_2_right : 21|10@0+ (1,0) [0|1023] "cm"  APS
 SG_ USS_CE2_3_right : 27|10@0+ (1,0) [0|1023] "cm"  APS
 SG_ USS_CE2_4_right : 33|10@0+ (1,0) [0|1023] "cm"  APS
 SG_ Rolling_counter1_0x17E : 59|4@0+ (1,0) [0|15] ""  APS
 SG_ USS_CE2_5_right : 55|10@0+ (1,0) [0|1023] "cm"  APS
 SG_ Checksum2_0x17E : 71|8@0+ (1,0) [0|255] ""  APS
 SG_ USS_CE2_7_right : 79|10@0+ (1,0) [0|1023] "cm"  APS
 SG_ USS_CE2_8_right : 85|10@0+ (1,0) [0|1023] "cm"  APS
 SG_ USS_CE2_9_right : 91|10@0+ (1,0) [0|1023] "cm"  APS
 SG_ USS_CE2_10_right : 97|10@0+ (1,0) [0|1023] "cm"  APS
 SG_ Rolling_counter2_0x17E : 123|4@0+ (1,0) [0|15] ""  APS
 SG_ USS_CE2_11_right : 119|10@0+ (1,0) [0|1023] "cm"  APS
 SG_ Checksum3_0x17E : 135|8@0+ (1,0) [0|255] ""  APS
 SG_ USS_CE2_6_left : 143|10@0+ (1,0) [0|1023] "cm"  APS
 SG_ USS_CE2_2_left : 149|10@0+ (1,0) [0|1023] "cm"  APS
 SG_ USS_CE2_3_left : 155|10@0+ (1,0) [0|1023] "cm"  APS
 SG_ USS_CE2_4_left : 161|10@0+ (1,0) [0|1023] "cm"  APS
 SG_ Rolling_counter3_0x17E : 187|4@0+ (1,0) [0|15] ""  APS
 SG_ USS_CE2_5_left : 183|10@0+ (1,0) [0|1023] "cm"  APS
 SG_ Checksum4_0x17E : 199|8@0+ (1,0) [0|255] ""  APS
 SG_ USS_CE2_12_left : 207|10@0+ (1,0) [0|1023] "cm"  APS
 SG_ USS_CE2_8_left : 213|10@0+ (1,0) [0|1023] "cm"  APS
 SG_ USS_CE2_9_left : 219|10@0+ (1,0) [0|1023] "cm"  APS
 SG_ USS_CE2_10_left : 225|10@0+ (1,0) [0|1023] "cm"  APS
 SG_ Rolling_counter4_0x17E : 251|4@0+ (1,0) [0|15] ""  APS
 SG_ USS_CE2_11_left : 247|10@0+ (1,0) [0|1023] "cm"  APS

BO_ 385 PA_0x181: 32 PA
 SG_ Checksum1_0x181 : 7|8@0+ (1,0) [0|255] ""  APS
 SG_ USS_DE3_2 : 15|10@0+ (1,0) [0|1023] "cm"  APS
 SG_ USS_DE3_3 : 17|10@0+ (1,0) [0|1023] "cm"  APS
 SG_ USS_DE3_4 : 39|10@0+ (1,0) [0|1023] "cm"  APS
 SG_ USS_DE3_5 : 41|10@0+ (1,0) [0|1023] "cm"  APS
 SG_ Rolling_counter1_0x181 : 59|4@0+ (1,0) [0|15] ""  APS
 SG_ Checksum2_0x181 : 71|8@0+ (1,0) [0|255] ""  APS
 SG_ USS_DE3_8 : 79|10@0+ (1,0) [0|1023] "cm"  APS
 SG_ USS_DE3_9 : 81|10@0+ (1,0) [0|1023] "cm"  APS
 SG_ USS_DE3_10 : 103|10@0+ (1,0) [0|1023] "cm"  APS
 SG_ USS_DE3_11 : 105|10@0+ (1,0) [0|1023] "cm"  APS
 SG_ Rolling_counter2_0x181 : 123|4@0+ (1,0) [0|15] ""  APS
 SG_ Checksum3_0x181 : 135|8@0+ (1,0) [0|255] ""  APS
 SG_ USS_DE3_1 : 143|10@0+ (1,0) [0|1023] "cm"  APS
 SG_ USS_DE3_6 : 145|10@0+ (1,0) [0|1023] "cm"  APS
 SG_ USS_DE3_7 : 167|10@0+ (1,0) [0|1023] "cm"  APS
 SG_ USS_DE3_12 : 169|10@0+ (1,0) [0|1023] "cm"  APS
 SG_ Rolling_counter3_0x181 : 187|4@0+ (1,0) [0|15] ""  APS

BO_ 386 PA_0x182: 32 PA
 SG_ Checksum1_0x182 : 7|8@0+ (1,0) [0|255] ""  APS
 SG_ USS_CE3_1_right : 15|10@0+ (1,0) [0|1023] "cm"  APS
 SG_ USS_CE3_2_right : 21|10@0+ (1,0) [0|1023] "cm"  APS
 SG_ USS_CE3_3_right : 27|10@0+ (1,0) [0|1023] "cm"  APS
 SG_ USS_CE3_4_right : 33|10@0+ (1,0) [0|1023] "cm"  APS
 SG_ Rolling_counter1_0x182 : 59|4@0+ (1,0) [0|15] ""  APS
 SG_ USS_CE3_5_right : 55|10@0+ (1,0) [0|1023] "cm"  APS
 SG_ Checksum2_0x182 : 71|8@0+ (1,0) [0|255] ""  APS
 SG_ USS_CE3_7_right : 79|10@0+ (1,0) [0|1023] "cm"  APS
 SG_ USS_CE3_8_right : 85|10@0+ (1,0) [0|1023] "cm"  APS
 SG_ USS_CE3_9_right : 91|10@0+ (1,0) [0|1023] "cm"  APS
 SG_ USS_CE3_10_right : 97|10@0+ (1,0) [0|1023] "cm"  APS
 SG_ Rolling_counter2_0x182 : 123|4@0+ (1,0) [0|15] ""  APS
 SG_ USS_CE3_11_right : 119|10@0+ (1,0) [0|1023] "cm"  APS
 SG_ Checksum3_0x182 : 135|8@0+ (1,0) [0|255] ""  APS
 SG_ USS_CE3_6_left : 143|10@0+ (1,0) [0|1023] "cm"  APS
 SG_ USS_CE3_2_left : 149|10@0+ (1,0) [0|1023] "cm"  APS
 SG_ USS_CE3_3_left : 155|10@0+ (1,0) [0|1023] "cm"  APS
 SG_ USS_CE3_4_left : 161|10@0+ (1,0) [0|1023] "cm"  APS
 SG_ Rolling_counter3_0x182 : 187|4@0+ (1,0) [0|15] ""  APS
 SG_ USS_CE3_5_left : 183|10@0+ (1,0) [0|1023] "cm"  APS
 SG_ Checksum4_0x182 : 199|8@0+ (1,0) [0|255] ""  APS
 SG_ USS_CE3_12_left : 207|10@0+ (1,0) [0|1023] "cm"  APS
 SG_ USS_CE3_8_left : 213|10@0+ (1,0) [0|1023] "cm"  APS
 SG_ USS_CE3_9_left : 219|10@0+ (1,0) [0|1023] "cm"  APS
 SG_ USS_CE3_10_left : 225|10@0+ (1,0) [0|1023] "cm"  APS
 SG_ Rolling_counter4_0x182 : 251|4@0+ (1,0) [0|15] ""  APS
 SG_ USS_CE3_11_left : 247|10@0+ (1,0) [0|1023] "cm"  APS

BO_ 387 PA_0x183: 32 PA
 SG_ Rolling_counter4_0x183 : 251|4@0+ (1,0) [0|15] ""  APS
 SG_ Checksum4_0x183 : 199|8@0+ (1,0) [0|255] ""  APS
 SG_ SDW_RR_2SideDistance : 247|8@0+ (1,0) [0|253] "cm"  APS
 SG_ SDW_RL_2SideDistance : 239|8@0+ (1,0) [0|253] "cm"  APS
 SG_ SDW_FR_2SideDistance : 231|8@0+ (1,0) [0|253] "cm"  APS
 SG_ SDW_FL_2SideDistance : 223|8@0+ (1,0) [0|253] "cm"  APS
 SG_ SDW_RR_1SideDistance : 215|8@0+ (1,0) [0|253] "cm"  APS
 SG_ SDW_RL_1SideDistance : 207|8@0+ (1,0) [0|253] "cm"  APS
 SG_ SDW_FR_1SideDistance : 183|8@0+ (1,0) [0|253] "cm"  APS
 SG_ SDW_FL_1SideDistance : 175|8@0+ (1,0) [0|253] "cm"  APS
 SG_ Rolling_counter3_0x183 : 187|4@0+ (1,0) [0|15] ""  APS
 SG_ Checksum3_0x183 : 135|8@0+ (1,0) [0|255] ""  APS
 SG_ PAS_RRM_Distance : 167|8@0+ (1,0) [0|253] "cm"  APS
 SG_ PAS_RR_Distance : 159|8@0+ (1,0) [0|253] "cm"  APS
 SG_ PAS_RLM_Distance : 151|8@0+ (1,0) [0|253] "cm"  APS
 SG_ PAS_RL_Distance : 143|8@0+ (1,0) [0|253] "cm"  APS
 SG_ Checksum1_0x183 : 7|8@0+ (1,0) [0|255] ""  APS
 SG_ PAS_FL_Distance : 15|8@0+ (1,0) [0|253] "cm"  APS
 SG_ PAS_FLM_Distance : 23|8@0+ (1,0) [0|253] "cm"  APS
 SG_ PAS_FR_Distance : 31|8@0+ (1,0) [0|253] "cm"  APS
 SG_ PAS_FRM_Distance : 39|8@0+ (1,0) [0|253] "cm"  APS
 SG_ Rolling_counter1_0x183 : 59|4@0+ (1,0) [0|15] ""  APS
 SG_ Checksum2_0x183 : 71|8@0+ (1,0) [0|255] ""  APS
 SG_ ApaVehX : 79|16@0+ (0.01,-327.68) [-327.68|327.67] "m"  APS
 SG_ ApaVehY : 95|16@0+ (0.01,-327.68) [-327.68|327.67] "m"  APS
 SG_ ApaVehYawAngle : 111|16@0+ (9.587526E-005,-3.1415926536) [-3.1415926536|3.141592636] "rad"  APS
 SG_ Rolling_counter2_0x183 : 123|4@0+ (1,0) [0|15] ""  APS

BO_ 688 PA_0x2B0: 32 PA
 SG_ RR_2SideAreaScand : 108|1@0+ (1,0) [0|1] ""  APS
 SG_ RL_2SideAreaScand : 109|1@0+ (1,0) [0|1] ""  APS
 SG_ FR_2SideAreaScand : 110|1@0+ (1,0) [0|1] ""  APS
 SG_ FL_2SideAreaScand : 111|1@0+ (1,0) [0|1] ""  APS
 SG_ SDW_RR_2SideDistance_range : 97|2@0+ (1,0) [0|3] ""  APS
 SG_ SDW_RL_2SideDistance_range : 99|2@0+ (1,0) [0|3] ""  APS
 SG_ SDW_FR_2SideDistance_range : 101|2@0+ (1,0) [0|3] ""  APS
 SG_ SDW_FL_2SideDistance_range : 103|2@0+ (1,0) [0|3] ""  APS
 SG_ Checksum1_0x2B0 : 7|8@0+ (1,0) [0|255] ""  APS
 SG_ PAS_Mode : 11|4@0+ (1,0) [0|15] ""  APS
 SG_ PASFLDistance_range : 15|3@0+ (1,0) [0|7] ""  APS
 SG_ PASFMRDistance_range : 18|3@0+ (1,0) [0|7] ""  APS
 SG_ PASFMLDistance_range : 23|3@0+ (1,0) [0|7] ""  APS
 SG_ PASRLDistance_range : 26|3@0+ (1,0) [0|7] ""  APS
 SG_ PASFRDistance_range : 31|3@0+ (1,0) [0|7] ""  APS
 SG_ PASRMLDistance_range : 34|3@0+ (1,0) [0|7] ""  APS
 SG_ PASRRDistance_range : 39|3@0+ (1,0) [0|7] ""  APS
 SG_ PASWarningType : 42|3@0+ (1,0) [0|7] ""  APS
 SG_ PASFailureReason : 44|2@0+ (1,0) [0|3] ""  APS
 SG_ PASRMRDistance_range : 47|3@0+ (1,0) [0|7] ""  APS
 SG_ Rolling_counter1_0x2B0 : 59|4@0+ (1,0) [0|15] ""  APS
 SG_ Checksum2_0x2B0 : 71|8@0+ (1,0) [0|255] ""  APS
 SG_ SDW_FL_1SideDistance_range : 73|2@0+ (1,0) [0|3] ""  APS
 SG_ SDW_FR_1SideDistance_range : 75|2@0+ (1,0) [0|3] ""  APS
 SG_ SDW_RL_1SideDistance_range : 77|2@0+ (1,0) [0|3] ""  APS
 SG_ SDW_RR_1SideDistance_range : 79|2@0+ (1,0) [0|3] ""  APS
 SG_ FL_1SideAreaScand : 80|1@0+ (1,0) [0|1] ""  APS
 SG_ FR_1SideAreaScand : 81|1@0+ (1,0) [0|1] ""  APS
 SG_ RL_1SideAreaScand : 82|1@0+ (1,0) [0|1] ""  APS
 SG_ RR_1SideAreaScand : 83|1@0+ (1,0) [0|1] ""  APS
 SG_ UPC_SDW_WorkMode : 87|2@0+ (1,0) [0|3] ""  APS
 SG_ APA_PSLSts : 95|3@0+ (1,0) [0|7] ""  APS
 SG_ Rolling_counter2_0x2B0 : 123|4@0+ (1,0) [0|15] ""  APS

BO_ 944 APS_TBOX_0x3B0: 32 APS
 SG_ TBOX_TimeSyncData_Year : 15|7@0+ (1,2000) [2000|2099] ""  PA
 SG_ TBOX_TimeSyncData_Month : 23|4@0+ (1,0) [1|12] ""  PA
 SG_ TBOX_TimeSyncData_Day : 31|5@0+ (1,0) [1|31] ""  PA
 SG_ TBOX_TimeSyncData_Hour : 39|5@0+ (1,0) [0|23] ""  PA
 SG_ TBOX_TimeSyncData_Minute : 47|6@0+ (1,0) [0|59] ""  PA
 SG_ TBOX_TimeSyncData_Second : 55|6@0+ (1,0) [0|59] ""  PA
 SG_ ICM_ODOTotal : 71|24@0+ (1,0) [0|999999] "KM"  PA

BO_ 1484 PA_0x5CC_Version: 32 PA
 SG_ PA_SWVersion_Supplier : 3|4@0+ (1,0) [0|15] ""  APS
 SG_ PA_SWVersion_Main : 7|4@0+ (1,0) [0|15] ""  APS
 SG_ PA_SWVersion_Sub1 : 11|4@0+ (1,0) [0|15] ""  APS
 SG_ PA_SWVersion_Sub2 : 15|4@0+ (1,0) [0|15] ""  APS
 SG_ PA_HWVersion_Supplier : 19|4@0+ (1,0) [0|15] ""  APS
 SG_ PA_HWVersion_Main : 23|4@0+ (1,0) [0|15] ""  APS
 SG_ PA_HWVersion_Sub1 : 27|4@0+ (1,0) [0|15] ""  APS
 SG_ PA_HWVersion_Sub2 : 31|4@0+ (1,0) [0|15] ""  APS

BO_ 1841 PA_UDSDiag_ReqPhsy: 8 APS
 SG_ PA_UDSDiag_ReqPhsy_0x731 : 7|64@0+ (1,0) [0|255] ""  PA

BO_ 1849 PA_UDSDiag_Resp: 8 PA
 SG_ PA_UDSDiag_Resp_0x739 : 7|64@0+ (1,0) [0|255] ""  APS

BO_ 2015 UDSDiag_ReqFunc: 8 APS
 SG_ UDSDiag_ReqFunc_0x7DF : 7|64@0+ (1,0) [0|255] ""  PA

CM_ " ";
CM_ BO_ 3221225472 "This is a message for not used signals, created by Vector CANdb++ DBC OLE DB Provider.";
CM_ SG_ 3221225472 VBU_VehicleSysFaultLamp "整车系统故障";
CM_ BO_ 184 "方向盘转角";
CM_ SG_ 184 Checksum_0x175 "Checksum: 0x1 XOR 0x75 XOR Byte1 XOR Byte2 XOR Byte3 XOR Byte4 XOR Byte5 XOR Byte6 XOR Byte7。
APS无需计算,直接路由源报文0x175的checksum信号值,PA计算checksum值进行校验";
CM_ SG_ 184 SAS_SteerWheelAngle "The current angle of the steering wheel（Positive, to left Negative, to right）
转向角度，左正右负";
CM_ SG_ 184 SAS_SASStsSnsr "the flag of  SAS status
Punch:Steering angle status
SAS硬件故障状态";
CM_ SG_ 184 SAS_SASStsCal "The calibration status of SAS
传感器标定状态";
CM_ SG_ 184 Rolling_counter_0x175 "RollingCounter: used 4bit length signal and the arithmetic is increased from 0 to 15 by every message.
APS直接路由源报文0x175的rollingcounter信号值";
CM_ BO_ 336 "车速&轮速";
CM_ SG_ 336 Checksum_0x121 "Checksum: 0x1 XOR 0x21 XOR Byte1 XOR Byte2 XOR Byte3 XOR Byte4 XOR Byte5 XOR Byte6 XOR Byte7
APS无需计算,直接路由源报文0x121的checksum信号值,PA计算checksum值进行校验";
CM_ SG_ 336 ESP_VehicleSpeed_Valid "Vehicle speed value valid
车速有效";
CM_ SG_ 336 ESP_VehicleSpeed "Current Vehicle Speed
当前实际车速";
CM_ SG_ 336 ESP_EPBStatus "Indicating the status of EPB";
CM_ SG_ 336 ESP_VehicleStop "Indicates if vehicle is in standstill (if more or equal to two wheels are standstill).
Set to a desired state when standstill is surely reached.";
CM_ SG_ 336 ESP_VehicleStop_Valid "Check the validity of the signal of VehicleStop.";
CM_ SG_ 336 RollingCounter_0x121 "RollingCounter: used 4bit length signal and the arithmetic is increased from 0 to 15 by every message.
APS直接路由源报文0x121的rollingcounter信号值";
CM_ SG_ 336 Checksum_0x211 "Checksum: 0x2 XOR 0x11 XOR Byte9 XOR Byte10 XOR Byte11 XOR Byte12 XOR Byte13 XOR Byte14 XOR Byte15
APS无需计算,直接路由源报文0x211的checksum信号值,PA计算checksum值进行校验";
CM_ SG_ 336 ABS_WheelSpeed_FL "Current wheel speed information of front left wheel.
左前轮轮速";
CM_ SG_ 336 ABS_WheelSpeed_FR "Current wheel speed information of front right wheel.
右前轮轮速";
CM_ SG_ 336 ABS_WheelSpeed_RL "Current wheel speed information of rear left wheel.
左后轮轮速";
CM_ SG_ 336 ABS_WheelSpeed_RR "Current wheel speed information of rear right wheel.
右后轮轮速";
CM_ SG_ 336 RollingCounter_0x211 "RollingCounter: used 4bit length signal and the arithmetic is increased from 0 to 15 by every message.
APS直接路由源报文0x211的rollingcounter信号值";
CM_ SG_ 336 ABS_WheelSpeed_FL_Valid "Front left wheel speed valid
左前轮速有效";
CM_ SG_ 336 ABS_WheelSpeed_FR_Valid "Front right wheel speed valid
右前轮速有效";
CM_ SG_ 336 ABS_WheelSpeed_RL_Valid "Rear left wheel speed valid
左后轮速有效";
CM_ SG_ 336 ABS_WheelSpeed_RR_Valid "Rear right wheel speed valid
右后轮速有效";
CM_ SG_ 336 Checksum_0x214 "Checksum: 0x2 XOR 0x14 XOR Byte17 XOR Byte18 XOR Byte19 XOR Byte20 XOR Byte21 XOR Byte22 XOR Byte23
APS无需计算,直接路由源报文0x214的checksum信号值,PA计算checksum值进行校验";
CM_ SG_ 336 ESP_WheelDirection_FL "Front left wheel Moving direction";
CM_ SG_ 336 ESP_WheelDirection_FL_Valid "Indicating front left wheel direction signal valid or not.";
CM_ SG_ 336 ESP_WheelDirection_FR "Front right wheel  Moving direction";
CM_ SG_ 336 ESP_WheelDirection_FR_Valid "Indicating front right wheel direction signal valid or not.";
CM_ SG_ 336 ESP_WheelDirection_RL "Rear left wheel  Moving direction";
CM_ SG_ 336 ESP_WheelDirection_RL_Valid "Indicating rear left wheel direction signal valid or not.";
CM_ SG_ 336 ESP_WheelDirection_RR "Rear right wheel Moving direction";
CM_ SG_ 336 ESP_WheelDirection_RR_Valid "Indicating rear right wheel direction signal valid or not.";
CM_ SG_ 336 RollingCounter_0x214 "RollingCounter: used 4bit length signal and the arithmetic is increased from 0 to 15 by every message.
APS直接路由源报文0x214的rollingcounter信号值";
CM_ SG_ 336 Checksum_0x215 "Checksum: 0x2 XOR 0x15 XOR Byte25 XOR Byte26 XOR Byte27 XOR Byte28 XOR Byte29 XOR Byte30 XOR Byte31
APS无需计算,直接路由源报文0x215的checksum信号值,PA计算checksum值进行校验";
CM_ SG_ 336 ABS_WheelPulse_FL_Valid "Previous name: WheelPulse_FL_Valid: Means Indicating front left wheel pulse signal valid or not.";
CM_ SG_ 336 ABS_WheelPulse_FR_Valid "Previous name: WheelPulse_FR_Valid: Means Indicating front left wheel pulse signal valid or not.";
CM_ SG_ 336 ABS_WheelPulse_RL_Valid "Previous name: WheelPulse_RL_Valid: Means Indicating front left wheel pulse signal valid or not.";
CM_ SG_ 336 ABS_WheelPulse_RR_Valid "Previous name: WheelPulse_RR_Valid: Means Indicating front left wheel pulse signal valid or not.";
CM_ SG_ 336 ABS_WheelPulse_FL "Previous name: WheelPulse_FL, means Front left wheel pulse";
CM_ SG_ 336 ABS_WheelPulse_FR "Previous name: WheelPulse_FR, means Front left wheel pulse";
CM_ SG_ 336 ABS_WheelPulse_RL "Previous name: WheelPulse_RL, means Front left wheel pulse";
CM_ SG_ 336 ABS_WheelPulse_RR "Previous name: WheelPulse_RR, means Front left wheel pulse";
CM_ SG_ 336 RollingCounter_0x215 "RollingCounter: used 4bit length signal and the arithmetic is increased from 0 to 15 by every message.";
CM_ BO_ 338 "车辆横纵向&状态信息";
CM_ SG_ 338 Checksum1_0x152 "Checksum: IDMSB(0x1) XOR IDLSB(0x52) XOR Byte1 XOR Byte2 XOR Byte3 XOR Byte4 XOR Byte5 XOR Byte6 XOR Byte7";
CM_ SG_ 338 ESP_YawrateValue_valid "yaw rate signal value valid or not.横摆角速度信号是否有效";
CM_ SG_ 338 ESP_YawRateValue "yaw rate signal
横摆角速度";
CM_ SG_ 338 ESP_LongAccSensorValid "vehicle longitudinal acceleration  value valid or not.
车辆纵向加速度信号是否有效";
CM_ SG_ 338 ESP_LongAccSensor "vehicle longitudinal acceleration
车辆纵向加速度";
CM_ SG_ 338 ESP_LaterAccSensorValid "vehicle lateral acceleration value valid or not.
车辆横向加速度信号是否有效";
CM_ SG_ 338 ESP_LaterAccSensor "vehicle lateral acceleration
车辆横向加速度";
CM_ SG_ 338 Rolling_counter1_0x152 "RollingCounter: used 4bit length signal and the arithmetic is increased from 0 to 15 by every message.";
CM_ SG_ 338 Checksum2_0x152 "Checksum: IDMSB(0x1) XOR IDLSB(0x52) XOR Byte9 XOR Byte10 XOR Byte11 XOR Byte12 XOR Byte13 XOR Byte14 XOR Byte15";
CM_ SG_ 338 GW_VBU_GearLeverPos "当前实际档位
vehicle Current Gear position";
CM_ SG_ 338 GW_VBU_ReadySts "纯电动车Ready信号
vehicle Ready Status";
CM_ SG_ 338 GW_BCM_SystemPowerMode "整车电源状态
vehicle Power Status";
CM_ SG_ 338 GW_AC_OutTemperature "车外温度";
CM_ SG_ 338 Rolling_counter2_0x152 "RollingCounter: used 4bit length signal and the arithmetic is increased from 0 to 15 by every message.";
CM_ SG_ 369 Checksum1_0x171 "Checksum: IDMSB(0x1) XOR IDLSB(0x71) XOR Byte1 XOR Byte2 XOR Byte3 XOR Byte4 XOR Byte5 XOR Byte6 XOR Byte7";
CM_ SG_ 369 ParkslotI_Selected "车辆标识符选择";
CM_ SG_ 369 APS_Workingsts "APS Parking Slot Searching Status  IndicationPAS_PSL工作进程";
CM_ SG_ 369 Rolling_counter1_0x171 "RollingCounter: used 4bit length signal and the arithmetic is increased from 0 to 15 by every message.";
CM_ SG_ 370 Checksum1_0x172 "Checksum: IDMSB(0x1) XOR IDLSB(0x72) XOR Byte1 XOR Byte2 XOR Byte3 XOR Byte4 XOR Byte5 XOR Byte6 XOR Byte7";
CM_ SG_ 370 MapObj01Type "MapObj01Type";
CM_ SG_ 370 MapObj01Prob "MapObj01Prob";
CM_ SG_ 370 MapObj01P1X "MapObj01P1X以车辆后轴中心为原点的障碍物point 1的X坐标";
CM_ SG_ 370 MapObj01HeightProb "MapObj01HeightProb";
CM_ SG_ 370 MapObj01P1Y "MapObj01P1Y以车辆后轴中心为原点的障碍物point 1的Y坐标";
CM_ SG_ 370 MapObj01P2X "MapObj01P2X以车辆后轴中心为原点的障碍物point 2的X坐标";
CM_ SG_ 370 Rolling_counter1_0x172 "RollingCounter: used 4bit length signal and the arithmetic is increased from 0 to 15 by every message.";
CM_ SG_ 370 MapObj01Height "MapObj01Height";
CM_ SG_ 370 MapObj01P2Y "MapObj01P2Y以车辆后轴中心为原点的障碍物point 2的Y坐标";
CM_ SG_ 370 Checksum2_0x172 "Checksum: IDMSB(0x1) XOR IDLSB(0x72) XOR Byte9 XOR Byte10 XOR Byte11 XOR Byte12 XOR Byte13 XOR Byte14 XOR Byte15";
CM_ SG_ 370 MapObj02Type "MapObj02Type";
CM_ SG_ 370 MapObj02Prob "MapObj02Prob";
CM_ SG_ 370 MapObj02P1X "MapObj02P1X以车辆后轴中心为原点的障碍物point 1的X坐标";
CM_ SG_ 370 MapObj02HeightProb "MapObj02HeightProb";
CM_ SG_ 370 MapObj02P1Y "MapObj02P1Y以车辆后轴中心为原点的障碍物point 1的Y坐标";
CM_ SG_ 370 MapObj02P2X "MapObj02P2X以车辆后轴中心为原点的障碍物point 2的X坐标";
CM_ SG_ 370 Rolling_counter2_0x172 "RollingCounter: used 4bit length signal and the arithmetic is increased from 0 to 15 by every message.";
CM_ SG_ 370 MapObj02Height "MapObj02Height";
CM_ SG_ 370 MapObj02P2Y "MapObj02P2Y以车辆后轴中心为原点的障碍物point 2的Y坐标";
CM_ SG_ 370 Checksum3_0x172 "Checksum: IDMSB(0x1) XOR IDLSB(0x72) XOR Byte17 XOR Byte18 XOR Byte19 XOR Byte20 XOR Byte21 XOR Byte22 XOR Byte23";
CM_ SG_ 370 MapObj03Type "MapObj03Type";
CM_ SG_ 370 MapObj03Prob "MapObj03Prob";
CM_ SG_ 370 MapObj03P1X "MapObj03P1X以车辆后轴中心为原点的障碍物point 1的X坐标";
CM_ SG_ 370 MapObj03HeightProb "MapObj03HeightProb";
CM_ SG_ 370 MapObj03P1Y "MapObj03P1Y以车辆后轴中心为原点的障碍物point 1的Y坐标";
CM_ SG_ 370 MapObj03P2X "MapObj03P2X以车辆后轴中心为原点的障碍物point 2的X坐标";
CM_ SG_ 370 Rolling_counter3_0x172 "RollingCounter: used 4bit length signal and the arithmetic is increased from 0 to 15 by every message.";
CM_ SG_ 370 MapObj03Height "MapObj03Height";
CM_ SG_ 370 MapObj03P2Y "MapObj03P2Y以车辆后轴中心为原点的障碍物point 2的Y坐标";
CM_ SG_ 370 Checksum4_0x172 "Checksum: IDMSB(0x1) XOR IDLSB(0x72) XOR Byte25 XOR Byte26 XOR Byte27 XOR Byte28 XOR Byte29 XOR Byte30 XOR Byte31";
CM_ SG_ 370 MapObj04Type "MapObj04Type";
CM_ SG_ 370 MapObj04Prob "MapObj04Prob";
CM_ SG_ 370 MapObj04P1X "MapObj04P1X以车辆后轴中心为原点的障碍物point 1的X坐标";
CM_ SG_ 370 MapObj04HeightProb "MapObj04HeightProb";
CM_ SG_ 370 MapObj04P1Y "MapObj04P1Y以车辆后轴中心为原点的障碍物point 1的Y坐标";
CM_ SG_ 370 MapObj04P2X "MapObj04P2X以车辆后轴中心为原点的障碍物point 2的X坐标";
CM_ SG_ 370 Rolling_counter4_0x172 "RollingCounter: used 4bit length signal and the arithmetic is increased from 0 to 15 by every message.";
CM_ SG_ 370 MapObj04Height "MapObj04Height";
CM_ SG_ 370 MapObj04P2Y "MapObj04P2Y以车辆后轴中心为原点的障碍物point 2的Y坐标";
CM_ SG_ 371 Checksum1_0x173 "Checksum: IDMSB(0x1) XOR IDLSB(0x73) XOR Byte1 XOR Byte2 XOR Byte3 XOR Byte4 XOR Byte5 XOR Byte6 XOR Byte7";
CM_ SG_ 371 MapObj05Type "MapObj05Type";
CM_ SG_ 371 MapObj05Prob "MapObj05Prob";
CM_ SG_ 371 MapObj05P1X "MapObj05P1X以车辆后轴中心为原点的障碍物point 1的X坐标";
CM_ SG_ 371 MapObj05HeightProb "MapObj05HeightProb";
CM_ SG_ 371 MapObj05P1Y "MapObj05P1Y以车辆后轴中心为原点的障碍物point 1的Y坐标";
CM_ SG_ 371 MapObj05P2X "MapObj05P2X以车辆后轴中心为原点的障碍物point 2的X坐标";
CM_ SG_ 371 Rolling_counter1_0x173 "RollingCounter: used 4bit length signal and the arithmetic is increased from 0 to 15 by every message.";
CM_ SG_ 371 MapObj05Height "MapObj05Height";
CM_ SG_ 371 MapObj05P2Y "MapObj05P2Y以车辆后轴中心为原点的障碍物point 2的Y坐标";
CM_ SG_ 371 Checksum2_0x173 "Checksum: IDMSB(0x1) XOR IDLSB(0x73) XOR Byte9 XOR Byte10 XOR Byte11 XOR Byte12 XOR Byte13 XOR Byte14 XOR Byte15";
CM_ SG_ 371 MapObj06Type "MapObj06Type";
CM_ SG_ 371 MapObj06Prob "MapObj06Prob";
CM_ SG_ 371 MapObj06P1X "MapObj06P1X以车辆后轴中心为原点的障碍物point 1的X坐标";
CM_ SG_ 371 MapObj06HeightProb "MapObj06HeightProb";
CM_ SG_ 371 MapObj06P1Y "MapObj06P1Y以车辆后轴中心为原点的障碍物point 1的Y坐标";
CM_ SG_ 371 MapObj06P2X "MapObj06P2X以车辆后轴中心为原点的障碍物point 2的X坐标";
CM_ SG_ 371 Rolling_counter2_0x173 "RollingCounter: used 4bit length signal and the arithmetic is increased from 0 to 15 by every message.";
CM_ SG_ 371 MapObj06Height "MapObj06Height";
CM_ SG_ 371 MapObj06P2Y "MapObj06P2Y以车辆后轴中心为原点的障碍物point 2的Y坐标";
CM_ SG_ 371 Checksum3_0x173 "Checksum: IDMSB(0x1) XOR IDLSB(0x73) XOR Byte17 XOR Byte18 XOR Byte19 XOR Byte20 XOR Byte21 XOR Byte22 XOR Byte23";
CM_ SG_ 371 MapObj07Type "MapObj07Type";
CM_ SG_ 371 MapObj07Prob "MapObj07Prob";
CM_ SG_ 371 MapObj07P1X "MapObj07P1X以车辆后轴中心为原点的障碍物point 1的X坐标";
CM_ SG_ 371 MapObj07HeightProb "MapObj07HeightProb";
CM_ SG_ 371 MapObj07P1Y "MapObj07P1Y以车辆后轴中心为原点的障碍物point 1的Y坐标";
CM_ SG_ 371 MapObj07P2X "MapObj07P2X以车辆后轴中心为原点的障碍物point 2的X坐标";
CM_ SG_ 371 Rolling_counter3_0x173 "RollingCounter: used 4bit length signal and the arithmetic is increased from 0 to 15 by every message.";
CM_ SG_ 371 MapObj07Height "MapObj07Height";
CM_ SG_ 371 MapObj07P2Y "MapObj07P2Y以车辆后轴中心为原点的障碍物point 2的Y坐标";
CM_ SG_ 371 Checksum4_0x173 "Checksum: IDMSB(0x1) XOR IDLSB(0x73) XOR Byte25 XOR Byte26 XOR Byte27 XOR Byte28 XOR Byte29 XOR Byte30 XOR Byte31";
CM_ SG_ 371 MapObj08Type "MapObj08Type";
CM_ SG_ 371 MapObj08Prob "MapObj08Prob";
CM_ SG_ 371 MapObj08P1X "MapObj08P1X以车辆后轴中心为原点的障碍物point 1的X坐标";
CM_ SG_ 371 MapObj08HeightProb "MapObj08HeightProb";
CM_ SG_ 371 MapObj08P1Y "MapObj08P1Y以车辆后轴中心为原点的障碍物point 1的Y坐标";
CM_ SG_ 371 MapObj08P2X "MapObj08P2X以车辆后轴中心为原点的障碍物point 2的X坐标";
CM_ SG_ 371 Rolling_counter4_0x173 "RollingCounter: used 4bit length signal and the arithmetic is increased from 0 to 15 by every message.";
CM_ SG_ 371 MapObj08Height "MapObj08Height";
CM_ SG_ 371 MapObj08P2Y "MapObj08P2Y以车辆后轴中心为原点的障碍物point 2的Y坐标";
CM_ SG_ 372 Checksum1_0x174 "Checksum: IDMSB(0x1) XOR IDLSB(0x74) XOR Byte1 XOR Byte2 XOR Byte3 XOR Byte4 XOR Byte5 XOR Byte6 XOR Byte7";
CM_ SG_ 372 MapObj09Type "MapObj09Type";
CM_ SG_ 372 MapObj09Prob "MapObj09Prob";
CM_ SG_ 372 MapObj09P1X "MapObj09P1X以车辆后轴中心为原点的障碍物point 1的X坐标";
CM_ SG_ 372 MapObj09HeightProb "MapObj09HeightProb";
CM_ SG_ 372 MapObj09P1Y "MapObj09P1Y以车辆后轴中心为原点的障碍物point 1的Y坐标";
CM_ SG_ 372 MapObj09P2X "MapObj09P2X以车辆后轴中心为原点的障碍物point 2的X坐标";
CM_ SG_ 372 Rolling_counter1_0x174 "RollingCounter: used 4bit length signal and the arithmetic is increased from 0 to 15 by every message.";
CM_ SG_ 372 MapObj09Height "MapObj09Height";
CM_ SG_ 372 MapObj09P2Y "MapObj09P2Y以车辆后轴中心为原点的障碍物point 2的Y坐标";
CM_ SG_ 372 Checksum2_0x174 "Checksum: IDMSB(0x1) XOR IDLSB(0x74) XOR Byte9 XOR Byte10 XOR Byte11 XOR Byte12 XOR Byte13 XOR Byte14 XOR Byte15";
CM_ SG_ 372 MapObj10Type "MapObj10Type";
CM_ SG_ 372 MapObj10Prob "MapObj10Prob";
CM_ SG_ 372 MapObj10P1X "MapObj10P1X以车辆后轴中心为原点的障碍物point 1的X坐标";
CM_ SG_ 372 MapObj10HeightProb "MapObj10HeightProb";
CM_ SG_ 372 MapObj10P1Y "MapObj10P1Y以车辆后轴中心为原点的障碍物point 1的Y坐标";
CM_ SG_ 372 MapObj10P2X "MapObj10P2X以车辆后轴中心为原点的障碍物point 2的X坐标";
CM_ SG_ 372 Rolling_counter2_0x174 "RollingCounter: used 4bit length signal and the arithmetic is increased from 0 to 15 by every message.";
CM_ SG_ 372 MapObj10Height "MapObj10Height";
CM_ SG_ 372 MapObj10P2Y "MapObj10P2Y以车辆后轴中心为原点的障碍物point 2的Y坐标";
CM_ SG_ 372 Checksum3_0x174 "Checksum: IDMSB(0x1) XOR IDLSB(0x74) XOR Byte17 XOR Byte18 XOR Byte19 XOR Byte20 XOR Byte21 XOR Byte22 XOR Byte23";
CM_ SG_ 372 MapObj11Type "MapObj11Type";
CM_ SG_ 372 MapObj11Prob "MapObj11Prob";
CM_ SG_ 372 MapObj11P1X "MapObj11P1X以车辆后轴中心为原点的障碍物point 1的X坐标";
CM_ SG_ 372 MapObj11HeightProb "MapObj11HeightProb";
CM_ SG_ 372 MapObj11P1Y "MapObj11P1Y以车辆后轴中心为原点的障碍物point 1的Y坐标";
CM_ SG_ 372 MapObj11P2X "MapObj11P2X以车辆后轴中心为原点的障碍物point 2的X坐标";
CM_ SG_ 372 Rolling_counter3_0x174 "RollingCounter: used 4bit length signal and the arithmetic is increased from 0 to 15 by every message.";
CM_ SG_ 372 MapObj11Height "MapObj11Height";
CM_ SG_ 372 MapObj11P2Y "MapObj11P2Y以车辆后轴中心为原点的障碍物point 2的Y坐标";
CM_ SG_ 372 Checksum4_0x174 "Checksum: IDMSB(0x1) XOR IDLSB(0x74) XOR Byte25 XOR Byte26 XOR Byte27 XOR Byte28 XOR Byte29 XOR Byte30 XOR Byte31";
CM_ SG_ 372 MapObj12Type "MapObj12Type";
CM_ SG_ 372 MapObj12Prob "MapObj12Prob";
CM_ SG_ 372 MapObj12P1X "MapObj12P1X以车辆后轴中心为原点的障碍物point 1的X坐标";
CM_ SG_ 372 MapObj12HeightProb "MapObj12HeightProb";
CM_ SG_ 372 MapObj12P1Y "MapObj12P1Y以车辆后轴中心为原点的障碍物point 1的Y坐标";
CM_ SG_ 372 MapObj12P2X "MapObj12P2X以车辆后轴中心为原点的障碍物point 2的X坐标";
CM_ SG_ 372 Rolling_counter4_0x174 "RollingCounter: used 4bit length signal and the arithmetic is increased from 0 to 15 by every message.";
CM_ SG_ 372 MapObj12Height "MapObj12Height";
CM_ SG_ 372 MapObj12P2Y "MapObj12P2Y以车辆后轴中心为原点的障碍物point 2的Y坐标";
CM_ SG_ 375 Checksum1_0x177 "Checksum: IDMSB(0x1) XOR IDLSB(0x77) XOR Byte1 XOR Byte2 XOR Byte3 XOR Byte4 XOR Byte5 XOR Byte6 XOR Byte7";
CM_ SG_ 375 MapObj13Type "MapObj13Type";
CM_ SG_ 375 MapObj13Prob "MapObj13Prob";
CM_ SG_ 375 MapObj13P1X "MapObj13P1X以车辆后轴中心为原点的障碍物point 1的X坐标";
CM_ SG_ 375 MapObj13HeightProb "MapObj13HeightProb";
CM_ SG_ 375 MapObj13P1Y "MapObj13P1Y以车辆后轴中心为原点的障碍物point 1的Y坐标";
CM_ SG_ 375 MapObj13P2X "MapObj13P2X以车辆后轴中心为原点的障碍物point 2的X坐标";
CM_ SG_ 375 Rolling_counter1_0x177 "RollingCounter: used 4bit length signal and the arithmetic is increased from 0 to 15 by every message.";
CM_ SG_ 375 MapObj13Height "MapObj13Height";
CM_ SG_ 375 MapObj13P2Y "MapObj13P2Y以车辆后轴中心为原点的障碍物point 2的Y坐标";
CM_ SG_ 375 Checksum2_0x177 "Checksum: IDMSB(0x1) XOR IDLSB(0x77) XOR Byte9
XOR Byte10 XOR Byte11 XOR Byte12 XOR Byte13 XOR Byte14 XOR Byte15";
CM_ SG_ 375 MapObj14Type "MapObj14Type";
CM_ SG_ 375 MapObj14Prob "MapObj14Prob";
CM_ SG_ 375 MapObj14P1X "MapObj14P1X以车辆后轴中心为原点的障碍物point 1的X坐标";
CM_ SG_ 375 MapObj14HeightProb "MapObj14HeightProb";
CM_ SG_ 375 MapObj14P1Y "MapObj14P1Y以车辆后轴中心为原点的障碍物point 1的Y坐标";
CM_ SG_ 375 MapObj14P2X "MapObj14P2X以车辆后轴中心为原点的障碍物point 2的X坐标";
CM_ SG_ 375 Rolling_counter2_0x177 "RollingCounter: used 4bit length signal and the arithmetic is increased from 0 to 15 by every message.";
CM_ SG_ 375 MapObj14Height "MapObj14Height";
CM_ SG_ 375 MapObj14P2Y "MapObj14P2Y以车辆后轴中心为原点的障碍物point 2的Y坐标";
CM_ SG_ 375 Checksum3_0x177 "Checksum: IDMSB(0x1) XOR IDLSB(0x77) XOR Byte17
XOR Byte18 XOR Byte19 XOR Byte20 XOR Byte21 XOR Byte22 XOR Byte23";
CM_ SG_ 375 MapObj15Type "MapObj15Type";
CM_ SG_ 375 MapObj15Prob "MapObj15Prob";
CM_ SG_ 375 MapObj15P1X "MapObj15P1X以车辆后轴中心为原点的障碍物point 1的X坐标";
CM_ SG_ 375 MapObj15HeightProb "MapObj15HeightProb";
CM_ SG_ 375 MapObj15P1Y "MapObj15P1Y以车辆后轴中心为原点的障碍物point 1的Y坐标";
CM_ SG_ 375 MapObj15P2X "MapObj15P2X以车辆后轴中心为原点的障碍物point 2的X坐标";
CM_ SG_ 375 Rolling_counter3_0x177 "RollingCounter: used 4bit length signal and the arithmetic is increased from 0 to 15 by every message.";
CM_ SG_ 375 MapObj15Height "MapObj15Height";
CM_ SG_ 375 MapObj15P2Y "MapObj15P2Y以车辆后轴中心为原点的障碍物point 2的Y坐标";
CM_ SG_ 375 Checksum4_0x177 "Checksum: IDMSB(0x1) XOR IDLSB(0x77) XOR Byte25
XOR Byte26 XOR Byte27 XOR Byte28 XOR Byte29 XOR Byte30 XOR Byte31";
CM_ SG_ 375 MapObj16Type "MapObj16Type";
CM_ SG_ 375 MapObj16Prob "MapObj16Prob";
CM_ SG_ 375 MapObj16P1X "MapObj16P1X以车辆后轴中心为原点的障碍物point 1的X坐标";
CM_ SG_ 375 MapObj16HeightProb "MapObj16HeightProb";
CM_ SG_ 375 MapObj16P1Y "MapObj16P1Y以车辆后轴中心为原点的障碍物point 1的Y坐标";
CM_ SG_ 375 MapObj16P2X "MapObj16P2X以车辆后轴中心为原点的障碍物point 2的X坐标";
CM_ SG_ 375 Rolling_counter4_0x177 "RollingCounter: used 4bit length signal and the arithmetic is increased from 0 to 15 by every message.";
CM_ SG_ 375 MapObj16Height "MapObj16Height";
CM_ SG_ 375 MapObj16P2Y "MapObj16P2Y以车辆后轴中心为原点的障碍物point 2的Y坐标";
CM_ SG_ 376 Checksum1_0x178 "Checksum: IDMSB(0x1) XOR IDLSB (0x78)XOR Byte1 XOR Byte2 XOR Byte3 XOR Byte4 XOR Byte5 XOR Byte6 XOR Byte7";
CM_ SG_ 376 MapObj17Type "MapObj17Type";
CM_ SG_ 376 MapObj17Prob "MapObj17Prob";
CM_ SG_ 376 MapObj17P1X "MapObj17P1X以车辆后轴中心为原点的障碍物point 1的X坐标";
CM_ SG_ 376 MapObj17HeightProb "MapObj17HeightProb";
CM_ SG_ 376 MapObj17P1Y "MapObj17P1Y以车辆后轴中心为原点的障碍物point 1的Y坐标";
CM_ SG_ 376 MapObj17P2X "MapObj17P2X以车辆后轴中心为原点的障碍物point 2的X坐标";
CM_ SG_ 376 Rolling_counter1_0x178 "RollingCounter: used 4bit length signal and the arithmetic is increased from 0 to 15 by every message.";
CM_ SG_ 376 MapObj17Height "MapObj17Height";
CM_ SG_ 376 MapObj17P2Y "MapObj17P2Y以车辆后轴中心为原点的障碍物point 2的Y坐标";
CM_ SG_ 376 Checksum2_0x178 "Checksum: IDMSB(0x1) XOR IDLSB(0x78) XOR Byte9
XOR Byte10 XOR Byte11 XOR Byte12 XOR Byte13 XOR Byte14 XOR Byte15";
CM_ SG_ 376 MapObj18Type "MapObj18Type";
CM_ SG_ 376 MapObj18Prob "MapObj18Prob";
CM_ SG_ 376 MapObj18P1X "MapObj18P1X以车辆后轴中心为原点的障碍物point 1的X坐标";
CM_ SG_ 376 MapObj18HeightProb "MapObj18HeightProb";
CM_ SG_ 376 MapObj18P1Y "MapObj18P1Y以车辆后轴中心为原点的障碍物point 1的Y坐标";
CM_ SG_ 376 MapObj18P2X "MapObj18P2X以车辆后轴中心为原点的障碍物point 2的X坐标";
CM_ SG_ 376 Rolling_counter2_0x178 "RollingCounter: used 4bit length signal and the arithmetic is increased from 0 to 15 by every message.";
CM_ SG_ 376 MapObj18Height "MapObj18Height";
CM_ SG_ 376 MapObj18P2Y "MapObj18P2Y以车辆后轴中心为原点的障碍物point 2的Y坐标";
CM_ SG_ 376 Checksum3_0x178 "Checksum: IDMSB(0x1) XOR IDLSB(0x78) XOR Byte17
XOR Byte18 XOR Byte19 XOR Byte20 XOR Byte21 XOR Byte22 XOR Byte23";
CM_ SG_ 376 MapObj19Type "MapObj19Type";
CM_ SG_ 376 MapObj19Prob "MapObj19Prob";
CM_ SG_ 376 MapObj19P1X "MapObj19P1X以车辆后轴中心为原点的障碍物point 1的X坐标";
CM_ SG_ 376 MapObj19HeightProb "MapObj19HeightProb";
CM_ SG_ 376 MapObj19P1Y "MapObj19P1Y以车辆后轴中心为原点的障碍物point 1的Y坐标";
CM_ SG_ 376 MapObj19P2X "MapObj19P2X以车辆后轴中心为原点的障碍物point 2的X坐标";
CM_ SG_ 376 Rolling_counter3_0x178 "RollingCounter: used 4bit length signal and the arithmetic is increased from 0 to 15 by every message.";
CM_ SG_ 376 MapObj19Height "MapObj19Height";
CM_ SG_ 376 MapObj19P2Y "MapObj19P2Y以车辆后轴中心为原点的障碍物point 2的Y坐标";
CM_ SG_ 376 Checksum4_0x178 "Checksum: IDMSB(0x1) XOR IDLSB(0x78) XOR Byte25
XOR Byte26 XOR Byte27 XOR Byte28 XOR Byte29 XOR Byte30 XOR Byte31";
CM_ SG_ 376 MapObj20Type "MapObj20Type";
CM_ SG_ 376 MapObj20Prob "MapObj20Prob";
CM_ SG_ 376 MapObj20P1X "MapObj20P1X以车辆后轴中心为原点的障碍物point 1的X坐标";
CM_ SG_ 376 MapObj20HeightProb "MapObj20HeightProb";
CM_ SG_ 376 MapObj20P1Y "MapObj20P1Y以车辆后轴中心为原点的障碍物point 1的Y坐标";
CM_ SG_ 376 MapObj20P2X "MapObj20P2X以车辆后轴中心为原点的障碍物point 2的X坐标";
CM_ SG_ 376 Rolling_counter4_0x178 "RollingCounter: used 4bit length signal and the arithmetic is increased from 0 to 15 by every message.";
CM_ SG_ 376 MapObj20Height "MapObj20Height";
CM_ SG_ 376 MapObj20P2Y "MapObj20P2Y以车辆后轴中心为原点的障碍物point 2的Y坐标";
CM_ SG_ 377 Checksum1_0x179 "Checksum: IDMSB(0x1) XOR IDLSB(0x79) XOR Byte1 XOR Byte2 XOR Byte3 XOR Byte4 XOR Byte5 XOR Byte6 XOR Byte7";
CM_ SG_ 377 ParkLeftslot0ID "车辆左侧标识符";
CM_ SG_ 377 ApaPscLeftSlot0Obj1X "the corner of the Left parking space of first object (x-direction)以车辆后轴中心为原点，左边车位第一个顶点的X坐标";
CM_ SG_ 377 ApaPscLeftSlot0Obj1Y "the corner of the Left parking space of first object (y-direction)以车辆后轴中心为原点，左边车位第一个顶点的Y坐标";
CM_ SG_ 377 ApaPscLeftSlot0Obj2X "the corner of the Left parking space of second object (x-direction)以车辆后轴中心为原点，左边车位第二个顶点的X坐标";
CM_ SG_ 377 Rolling_counter1_0x179 "RollingCounter: used 4bit length signal and the arithmetic is increased from 0 to 15 by every message.";
CM_ SG_ 377 ApaPscLeftSlot0Obj2Y "the corner of the Left parking space of second object (y-direction)以车辆后轴中心为原点，左边车位第二个顶点的Y坐标";
CM_ SG_ 377 Checksum2_0x179 "Checksum: IDMSB(0x1) XOR IDLSB(0x79) XOR Byte9
XOR Byte10 XOR Byte11 XOR Byte12 XOR Byte13 XOR Byte14 XOR Byte15";
CM_ SG_ 377 ApaPscLeftSlot0Obj1Alpha "Left Parking slot object 1 orientation以车辆后轴中心为原点，左边第一个障碍物的角度";
CM_ SG_ 377 ApaPscLeftSlot0Obj2Alpha "Left Parking slot object 2 orientation以车辆后轴中心为原点，左边第二个障碍物的角度";
CM_ SG_ 377 ApaPsc_LeftPSL0_Depth "the depth of the left parking slot左侧车位的深度";
CM_ SG_ 377 ApaPscLeftSlot0Tpye "车位类型";
CM_ SG_ 377 ApaPsc_LeftPSL0_Length "the length of the left parking slot左侧车位的长度";
CM_ SG_ 377 ApaPsc_LeftPSL0_ObjectType "Object type behind the parking slot
车位后障碍物类型";
CM_ SG_ 377 Rolling_counter2_0x179 "RollingCounter: used 4bit length signal and the arithmetic is increased from 0 to 15 by every message.";
CM_ SG_ 377 Checksum3_0x179 "Checksum: IDMSB(0x1) XOR IDLSB(0x79) XOR Byte17
XOR Byte18 XOR Byte19 XOR Byte20 XOR Byte21 XOR Byte22 XOR Byte23";
CM_ SG_ 377 ParkLeftslot1ID "车辆左侧标识符";
CM_ SG_ 377 ApaPscLeftSlot1Obj1X "the corner of the Left parking space of first object (x-direction)以车辆后轴中心为原点，左边车位第一个顶点的X坐标";
CM_ SG_ 377 ApaPscLeftSlot1Obj1Y "the corner of the Left parking space of first object (y-direction)以车辆后轴中心为原点，左边车位第一个顶点的Y坐标";
CM_ SG_ 377 ApaPscLeftSlot1Obj2X "the corner of the Left parking space of second object (x-direction)以车辆后轴中心为原点，左边车位第二个顶点的X坐标";
CM_ SG_ 377 Rolling_counter3_0x179 "RollingCounter: used 4bit length signal and the arithmetic is increased from 0 to 15 by every message.";
CM_ SG_ 377 ApaPscLeftSlot1Obj2Y "the corner of the Left parking space of second object (y-direction)以车辆后轴中心为原点，左边车位第二个顶点的Y坐标";
CM_ SG_ 377 Checksum4_0x179 "Checksum: IDMSB(0x1) XOR IDLSB(0x79) XOR Byte25
XOR Byte26 XOR Byte27 XOR Byte28 XOR Byte29 XOR Byte30 XOR Byte31";
CM_ SG_ 377 ApaPscLeftSlot1Obj1Alpha "Left Parking slot object 1 orientation以车辆后轴中心为原点，左边第一个障碍物的角度";
CM_ SG_ 377 ApaPscLeftSlot1Obj2Alpha "Left Parking slot object 2 orientation以车辆后轴中心为原点，左边第二个障碍物的角度";
CM_ SG_ 377 ApaPsc_LeftPSL1_Depth "the depth of the left parking slot左侧车位的深度";
CM_ SG_ 377 ApaPscLeftSlot1Tpye "车位类型";
CM_ SG_ 377 ApaPsc_LeftPSL1_Length "the length of the left parking slot左侧车位的长度";
CM_ SG_ 377 ApaPsc_LeftPSL1_ObjectType "Object type behind the parking slot
车位后障碍物类型";
CM_ SG_ 377 Rolling_counter4_0x179 "RollingCounter: used 4bit length signal and the arithmetic is increased from 0 to 15 by every message.";
CM_ SG_ 378 Checksum1_0x17A "Checksum: IDMSB(0x1) XOR IDLSB(0x7A) XOR Byte1 XOR Byte2 XOR Byte3 XOR Byte4 XOR Byte5 XOR Byte6 XOR Byte7";
CM_ SG_ 378 ParkRightslot0ID "车辆标识符";
CM_ SG_ 378 ApaPscRightSlot0Obj1X "the corner of the right parking space of first object (x-direction)以车辆后轴中心为原点，右边车位第一个顶点的X坐标";
CM_ SG_ 378 ApaPscRightSlot0Obj1Y "the corner of the right parking space of first object (y-direction)以车辆后轴中心为原点，右边车位第一个顶点的Y坐标";
CM_ SG_ 378 ApaPscRightSlot0Obj2X "the corner of the right parking space of second object (x-direction)以车辆后轴中心为原点，右边车位第二个顶点的X坐标";
CM_ SG_ 378 Rolling_counter1_0x17A "RollingCounter: used 4bit length signal and the arithmetic is increased from 0 to 15 by every message.";
CM_ SG_ 378 ApaPscRightSlot0Obj2Y "the corner of the right parking space of second object (y-direction)以车辆后轴中心为原点，右边车位第二个顶点的Y坐标";
CM_ SG_ 378 Checksum2_0x17A "Checksum: IDMSB(0x1) XOR IDLSB(0x7A) XOR Byte9
XOR Byte10 XOR Byte11 XOR Byte12 XOR Byte13 XOR Byte14 XOR Byte15";
CM_ SG_ 378 ApaPscRightSlot0Obj1Alpha "right Parking slot object 1 orientation以车辆后轴中心为原点，右边第一个障碍物的角度";
CM_ SG_ 378 ApaPscRightSlot0Obj2Alpha "right Parking slot object 2 orientation以车辆后轴中心为原点，右边第二个障碍物的角度";
CM_ SG_ 378 ApaPsc_RightPSL0_Depth "the depth of the Right parking slot右侧车位的深度";
CM_ SG_ 378 ApaPscRightSlot0Tpye "车位类型";
CM_ SG_ 378 ApaPsc_RightPSL0_Length "the length of the Right parking slot右侧车位的长度";
CM_ SG_ 378 ApaPsc_RightPSL0_ObjectType "Object type behind the parking slot
车位后障碍物类型";
CM_ SG_ 378 Rolling_counter2_0x17A "RollingCounter: used 4bit length signal and the arithmetic is increased from 0 to 15 by every message.";
CM_ SG_ 378 Checksum3_0x17A "Checksum: IDMSB(0x1) XOR IDLSB(0x7A) XOR Byte17
XOR Byte18 XOR Byte19 XOR Byte20 XOR Byte21 XOR Byte22 XOR Byte23";
CM_ SG_ 378 ParkRightslot1ID "车辆标识符";
CM_ SG_ 378 ApaPscRightSlot1Obj1X "the corner of the right parking space of first object (x-direction)以车辆后轴中心为原点，右边车位第一个顶点的X坐标";
CM_ SG_ 378 ApaPscRightSlot1Obj1Y "the corner of the right parking space of first object (y-direction)以车辆后轴中心为原点，右边车位第一个顶点的Y坐标";
CM_ SG_ 378 ApaPscRightSlot1Obj2X "the corner of the right parking space of second object (x-direction)以车辆后轴中心为原点，右边车位第二个顶点的X坐标";
CM_ SG_ 378 Rolling_counter3_0x17A "RollingCounter: used 4bit length signal and the arithmetic is increased from 0 to 15 by every message.";
CM_ SG_ 378 ApaPscRightSlot1Obj2Y "the corner of the right parking space of second object (y-direction)以车辆后轴中心为原点，右边车位第二个顶点的Y坐标";
CM_ SG_ 378 Checksum4_0x17A "Checksum: IDMSB(0x1) XOR IDLSB(0x7A) XOR Byte25
XOR Byte26 XOR Byte27 XOR Byte28 XOR Byte29 XOR Byte30 XOR Byte31";
CM_ SG_ 378 ApaPscRightSlot1Obj1Alpha "right Parking slot object 1 orientation以车辆后轴中心为原点，右边第一个障碍物的角度";
CM_ SG_ 378 ApaPscRightSlot1Obj2Alpha "right Parking slot object 2 orientation以车辆后轴中心为原点，右边第二个障碍物的角度";
CM_ SG_ 378 ApaPsc_RightPSL1_Depth "the depth of the Right parking slot右侧车位的深度";
CM_ SG_ 378 ApaPscRightSlot1Tpye "车位类型";
CM_ SG_ 378 ApaPsc_RightPSL1_Length "the length of the Right parking slot右侧车位的长度";
CM_ SG_ 378 ApaPsc_RightPSL1_ObjectType "Object type behind the parking slot
车位后障碍物类型";
CM_ SG_ 378 Rolling_counter4_0x17A "RollingCounter: used 4bit length signal and the arithmetic is increased from 0 to 15 by every message.";
CM_ SG_ 379 Checksum1_0x17B "Checksum: IDMSB(0x1) XOR IDLSB(0x7B) XOR Byte1 XOR Byte2 XOR Byte3 XOR Byte4 XOR Byte5 XOR Byte6 XOR Byte7";
CM_ SG_ 379 USS_DE1_2 "The direct Echo distance from sensor 2号雷达直接回波距离";
CM_ SG_ 379 USS_DE1_3 "The direct Echo distance from sensor 3号雷达直接回波距离";
CM_ SG_ 379 USS_DE1_4 "The direct Echo distance from sensor 4号雷达直接回波距离";
CM_ SG_ 379 USS_DE1_5 "The direct Echo distance from sensor5号雷达直接回波距离";
CM_ SG_ 379 Rolling_counter1_0x17B "RollingCounter: used 4bit length signal and the arithmetic is increased from 0 to 15 by every message.";
CM_ SG_ 379 Checksum2_0x17B "Checksum: IDMSB(0x1) XOR IDLSB(0x7B) XOR Byte9
XOR Byte10 XOR Byte11 XOR Byte12 XOR Byte13 XOR Byte14 XOR Byte15";
CM_ SG_ 379 USS_DE1_8 "The direct Echo distance from sensor 8号雷达直接回波距离";
CM_ SG_ 379 USS_DE1_9 "The direct Echo distance from sensor 9号雷达直接回波距离";
CM_ SG_ 379 USS_DE1_10 "The direct Echo distance from sensor 10号雷达直接回波距离";
CM_ SG_ 379 USS_DE1_11 "The direct Echo distance from sensor 11号雷达直接回波距离";
CM_ SG_ 379 Rolling_counter2_0x17B "RollingCounter: used 4bit length signal and the arithmetic is increased from 0 to 15 by every message.";
CM_ SG_ 379 Checksum3_0x17B "Checksum: IDMSB(0x1) XOR IDLSB(0x7B) XOR Byte17
XOR Byte18 XOR Byte19 XOR Byte20 XOR Byte21 XOR Byte22 XOR Byte23";
CM_ SG_ 379 USS_DE1_1 "The direct Echo distance from sensor 1号雷达直接回波距离";
CM_ SG_ 379 USS_DE1_6 "The direc Echo distance from sensor 66号雷达直接回波距离";
CM_ SG_ 379 USS_DE1_7 "The direct Echo distance from sensor 7号雷达直接回波距离";
CM_ SG_ 379 USS_DE1_12 "The direct Echo distance from sensor 12号雷达直接回波距离";
CM_ SG_ 379 Rolling_counter3_0x17B "RollingCounter: used 4bit length signal and the arithmetic is increased from 0 to 15 by every message.";
CM_ SG_ 380 Checksum1_0x17C "Checksum: IDMSB(0x1) XOR IDLSB(0x7C) XOR Byte1 XOR Byte2 XOR Byte3 XOR Byte4 XOR Byte5 XOR Byte6 XOR Byte7";
CM_ SG_ 380 USS_CE1_1_right "The Cross Echo distance右侧间接回波距离";
CM_ SG_ 380 USS_CE1_2_right "The Cross Echo distance右侧间接回波距离";
CM_ SG_ 380 USS_CE1_3_right "The Cross Echo distance右侧间接回波距离";
CM_ SG_ 380 USS_CE1_4_right "The Cross Echo distance右侧间接回波距离";
CM_ SG_ 380 Rolling_counter1_0x17C "RollingCounter: used 4bit length signal and the arithmetic is increased from 0 to 15 by every message.";
CM_ SG_ 380 USS_CE1_5_right "The Cross Echo distance右侧间接回波距离";
CM_ SG_ 380 Checksum2_0x17C "Checksum: IDMSB(0x1) XOR IDLSB(0x7C) XOR Byte9
XOR Byte10 XOR Byte11 XOR Byte12 XOR Byte13 XOR Byte14 XOR Byte15";
CM_ SG_ 380 USS_CE1_7_right "The Cross Echo distance右侧间接回波距离";
CM_ SG_ 380 USS_CE1_8_right "The Cross Echo distance右侧间接回波距离";
CM_ SG_ 380 USS_CE1_9_right "The Cross Echo distance右侧间接回波距离";
CM_ SG_ 380 USS_CE1_10_right "The Cross Echo distance右侧间接回波距离";
CM_ SG_ 380 Rolling_counter2_0x17C "RollingCounter: used 4bit length signal and the arithmetic is increased from 0 to 15 by every message.";
CM_ SG_ 380 USS_CE1_11_right "The Cross Echo distance右侧间接回波距离";
CM_ SG_ 380 Checksum3_0x17C "Checksum: IDMSB(0x1) XOR IDLSB(0x7C) XOR Byte17
XOR Byte18 XOR Byte19 XOR Byte20 XOR Byte21 XOR Byte22 XOR Byte23";
CM_ SG_ 380 USS_CE1_2_left "The Cross Echo distance左侧间接回波距离";
CM_ SG_ 380 USS_CE1_3_left "The Cross Echo distance左侧间接回波距离";
CM_ SG_ 380 USS_CE1_4_left "The Cross Echo distance左侧间接回波距离";
CM_ SG_ 380 USS_CE1_5_left "The Cross Echo distance左侧间接回波距离";
CM_ SG_ 380 Rolling_counter3_0x17C "RollingCounter: used 4bit length signal and the arithmetic is increased from 0 to 15 by every message.";
CM_ SG_ 380 USS_CE1_6_left "The Cross Echo distance左侧间接回波距离";
CM_ SG_ 380 Checksum4_0x17C "Checksum: IDMSB(0x1) XOR IDLSB(0x7C) XOR Byte25
XOR Byte26 XOR Byte27 XOR Byte28 XOR Byte29 XOR Byte30 XOR Byte31";
CM_ SG_ 380 USS_CE1_8_left "The Cross Echo distance左侧间接回波距离";
CM_ SG_ 380 USS_CE1_9_left "The Cross Echo distance左侧间接回波距离";
CM_ SG_ 380 USS_CE1_10_left "The Cross Echo distance左侧间接回波距离";
CM_ SG_ 380 USS_CE1_11_left "The Cross Echo distance左侧间接回波距离";
CM_ SG_ 380 Rolling_counter4_0x17C "RollingCounter: used 4bit length signal and the arithmetic is increased from 0 to 15 by every message.";
CM_ SG_ 380 USS_CE1_12_left "The Cross Echo distance左侧间接回波距离";
CM_ SG_ 381 Checksum1_0x17D "Checksum: IDMSB(0x1) XOR IDLSB(0x7D) XOR Byte1 XOR Byte2 XOR Byte3 XOR Byte4 XOR Byte5 XOR Byte6 XOR Byte7";
CM_ SG_ 381 USS_DE2_2 "The direct Echo distance from sensor 2号雷达直接回波距离";
CM_ SG_ 381 USS_DE2_3 "The direct Echo distance from sensor 3号雷达直接回波距离";
CM_ SG_ 381 USS_DE2_4 "The direct Echo distance from sensor 4号雷达直接回波距离";
CM_ SG_ 381 USS_DE2_5 "The direct Echo distance from sensor5号雷达直接回波距离";
CM_ SG_ 381 Rolling_counter1_0x17D "RollingCounter: used 4bit length signal and the arithmetic is increased from 0 to 15 by every message.";
CM_ SG_ 381 Checksum2_0x17D "Checksum: IDMSB(0x1) XOR IDLSB(0x7D) XOR Byte9
XOR Byte10 XOR Byte11 XOR Byte12 XOR Byte13 XOR Byte14 XOR Byte15";
CM_ SG_ 381 USS_DE2_8 "The direct Echo distance from sensor 8号雷达直接回波距离";
CM_ SG_ 381 USS_DE2_9 "The direct Echo distance from sensor 9号雷达直接回波距离";
CM_ SG_ 381 USS_DE2_10 "The direct Echo distance from sensor 10号雷达直接回波距离";
CM_ SG_ 381 USS_DE2_11 "The direct Echo distance from sensor 11号雷达直接回波距离";
CM_ SG_ 381 Rolling_counter2_0x17D "RollingCounter: used 4bit length signal and the arithmetic is increased from 0 to 15 by every message.";
CM_ SG_ 381 Checksum3_0x17D "Checksum: IDMSB(0x1) XOR IDLSB(0x7D) XOR Byte17
XOR Byte18 XOR Byte19 XOR Byte20 XOR Byte21 XOR Byte22 XOR Byte23";
CM_ SG_ 381 USS_DE2_1 "The direct Echo distance from sensor 1号雷达直接回波距离";
CM_ SG_ 381 USS_DE2_6 "The direc Echo distance from sensor 66号雷达直接回波距离";
CM_ SG_ 381 USS_DE2_7 "The direct Echo distance from sensor 7号雷达直接回波距离";
CM_ SG_ 381 USS_DE2_12 "The direct Echo distance from sensor 12号雷达直接回波距离";
CM_ SG_ 381 Rolling_counter3_0x17D "RollingCounter: used 4bit length signal and the arithmetic is increased from 0 to 15 by every message.";
CM_ SG_ 382 Checksum1_0x17E "Checksum: IDMSB(0x1) XOR IDLSB(0x7E) XOR Byte1 XOR Byte2 XOR Byte3 XOR Byte4 XOR Byte5 XOR Byte6 XOR Byte7";
CM_ SG_ 382 USS_CE2_1_right "The Cross Echo distance右侧间接回波距离";
CM_ SG_ 382 USS_CE2_2_right "The Cross Echo distance右侧间接回波距离";
CM_ SG_ 382 USS_CE2_3_right "The Cross Echo distance右侧间接回波距离";
CM_ SG_ 382 USS_CE2_4_right "The Cross Echo distance右侧间接回波距离";
CM_ SG_ 382 Rolling_counter1_0x17E "RollingCounter: used 4bit length signal and the arithmetic is increased from 0 to 15 by every message.";
CM_ SG_ 382 USS_CE2_5_right "The Cross Echo distance右侧间接回波距离";
CM_ SG_ 382 Checksum2_0x17E "Checksum: IDMSB(0x1) XOR IDLSB(0x7E) XOR Byte9
XOR Byte10 XOR Byte11 XOR Byte12 XOR Byte13 XOR Byte14 XOR Byte15";
CM_ SG_ 382 USS_CE2_7_right "The Cross Echo distance右侧间接回波距离";
CM_ SG_ 382 USS_CE2_8_right "The Cross Echo distance右侧间接回波距离";
CM_ SG_ 382 USS_CE2_9_right "The Cross Echo distance右侧间接回波距离";
CM_ SG_ 382 USS_CE2_10_right "The Cross Echo distance右侧间接回波距离";
CM_ SG_ 382 Rolling_counter2_0x17E "RollingCounter: used 4bit length signal and the arithmetic is increased from 0 to 15 by every message.";
CM_ SG_ 382 USS_CE2_11_right "The Cross Echo distance右侧间接回波距离";
CM_ SG_ 382 Checksum3_0x17E "Checksum: IDMSB(0x1) XOR IDLSB(0x7E) XOR Byte17
XOR Byte18 XOR Byte19 XOR Byte20 XOR Byte21 XOR Byte22 XOR Byte23";
CM_ SG_ 382 USS_CE2_6_left "The Cross Echo distance左侧间接回波距离";
CM_ SG_ 382 USS_CE2_2_left "The Cross Echo distance左侧间接回波距离";
CM_ SG_ 382 USS_CE2_3_left "The Cross Echo distance左侧间接回波距离";
CM_ SG_ 382 USS_CE2_4_left "The Cross Echo distance左侧间接回波距离";
CM_ SG_ 382 Rolling_counter3_0x17E "RollingCounter: used 4bit length signal and the arithmetic is increased from 0 to 15 by every message.";
CM_ SG_ 382 USS_CE2_5_left "The Cross Echo distance左侧间接回波距离";
CM_ SG_ 382 Checksum4_0x17E "Checksum: IDMSB(0x1) XOR IDLSB(0x7E) XOR Byte25
XOR Byte26 XOR Byte27 XOR Byte28 XOR Byte29 XOR Byte30 XOR Byte31";
CM_ SG_ 382 USS_CE2_12_left "The Cross Echo distance左侧间接回波距离";
CM_ SG_ 382 USS_CE2_8_left "The Cross Echo distance左侧间接回波距离";
CM_ SG_ 382 USS_CE2_9_left "The Cross Echo distance左侧间接回波距离";
CM_ SG_ 382 USS_CE2_10_left "The Cross Echo distance左侧间接回波距离";
CM_ SG_ 382 Rolling_counter4_0x17E "RollingCounter: used 4bit length signal and the arithmetic is increased from 0 to 15 by every message.";
CM_ SG_ 382 USS_CE2_11_left "The Cross Echo distance左侧间接回波距离";
CM_ SG_ 385 Checksum1_0x181 "Checksum: IDMSB(0x1) XOR IDLSB(0x81) XOR Byte1 XOR Byte2 XOR Byte3 XOR Byte4 XOR Byte5 XOR Byte6 XOR Byte7";
CM_ SG_ 385 USS_DE3_2 "The direct Echo distance from sensor 2号雷达直接回波距离";
CM_ SG_ 385 USS_DE3_3 "The direct Echo distance from sensor 3号雷达直接回波距离";
CM_ SG_ 385 USS_DE3_4 "The direct Echo distance from sensor 4号雷达直接回波距离";
CM_ SG_ 385 USS_DE3_5 "The direct Echo distance from sensor5号雷达直接回波距离";
CM_ SG_ 385 Rolling_counter1_0x181 "RollingCounter: used 4bit length signal and the arithmetic is increased from 0 to 15 by every message.";
CM_ SG_ 385 Checksum2_0x181 "Checksum: IDMSB(0x1) XOR IDLSB(0x81) XOR Byte9
XOR Byte10 XOR Byte11 XOR Byte12 XOR Byte13 XOR Byte14 XOR Byte15";
CM_ SG_ 385 USS_DE3_8 "The direct Echo distance from sensor 8号雷达直接回波距离";
CM_ SG_ 385 USS_DE3_9 "The direct Echo distance from sensor 9号雷达直接回波距离";
CM_ SG_ 385 USS_DE3_10 "The direct Echo distance from sensor 10号雷达直接回波距离";
CM_ SG_ 385 USS_DE3_11 "The direct Echo distance from sensor 11号雷达直接回波距离";
CM_ SG_ 385 Rolling_counter2_0x181 "RollingCounter: used 4bit length signal and the arithmetic is increased from 0 to 15 by every message.";
CM_ SG_ 385 Checksum3_0x181 "Checksum: IDMSB(0x1) XOR IDLSB(0x81) XOR Byte17
XOR Byte18 XOR Byte19 XOR Byte20 XOR Byte21 XOR Byte22 XOR Byte23";
CM_ SG_ 385 USS_DE3_1 "The direct Echo distance from sensor 1号雷达直接回波距离";
CM_ SG_ 385 USS_DE3_6 "The direc Echo distance from sensor 66号雷达直接回波距离";
CM_ SG_ 385 USS_DE3_7 "The direct Echo distance from sensor 7号雷达直接回波距离";
CM_ SG_ 385 USS_DE3_12 "The direct Echo distance from sensor 12号雷达直接回波距离";
CM_ SG_ 385 Rolling_counter3_0x181 "RollingCounter: used 4bit length signal and the arithmetic is increased from 0 to 15 by every message.";
CM_ SG_ 386 Checksum1_0x182 "Checksum: IDMSB(0x1) XOR IDLSB(0x82) XOR Byte1 XOR Byte2 XOR Byte3 XOR Byte4 XOR Byte5 XOR Byte6 XOR Byte7";
CM_ SG_ 386 USS_CE3_1_right "The Cross Echo distance右侧间接回波距离";
CM_ SG_ 386 USS_CE3_2_right "The Cross Echo distance右侧间接回波距离";
CM_ SG_ 386 USS_CE3_3_right "The Cross Echo distance右侧间接回波距离";
CM_ SG_ 386 USS_CE3_4_right "The Cross Echo distance右侧间接回波距离";
CM_ SG_ 386 Rolling_counter1_0x182 "RollingCounter: used 4bit length signal and the arithmetic is increased from 0 to 15 by every message.";
CM_ SG_ 386 USS_CE3_5_right "The Cross Echo distance右侧间接回波距离";
CM_ SG_ 386 Checksum2_0x182 "Checksum: IDMSB(0x1) XOR IDLSB(0x82) XOR Byte9
XOR Byte10 XOR Byte11 XOR Byte12 XOR Byte13 XOR Byte14 XOR Byte15";
CM_ SG_ 386 USS_CE3_7_right "The Cross Echo distance右侧间接回波距离";
CM_ SG_ 386 USS_CE3_8_right "The Cross Echo distance右侧间接回波距离";
CM_ SG_ 386 USS_CE3_9_right "The Cross Echo distance右侧间接回波距离";
CM_ SG_ 386 USS_CE3_10_right "The Cross Echo distance右侧间接回波距离";
CM_ SG_ 386 Rolling_counter2_0x182 "RollingCounter: used 4bit length signal and the arithmetic is increased from 0 to 15 by every message.";
CM_ SG_ 386 USS_CE3_11_right "The Cross Echo distance右侧间接回波距离";
CM_ SG_ 386 Checksum3_0x182 "Checksum: IDMSB(0x1) XOR IDLSB(0x82) XOR Byte17
XOR Byte18 XOR Byte19 XOR Byte20 XOR Byte21 XOR Byte22 XOR Byte23";
CM_ SG_ 386 USS_CE3_6_left "The Cross Echo distance左侧间接回波距离";
CM_ SG_ 386 USS_CE3_2_left "The Cross Echo distance左侧间接回波距离";
CM_ SG_ 386 USS_CE3_3_left "The Cross Echo distance左侧间接回波距离";
CM_ SG_ 386 USS_CE3_4_left "The Cross Echo distance左侧间接回波距离";
CM_ SG_ 386 Rolling_counter3_0x182 "RollingCounter: used 4bit length signal and the arithmetic is increased from 0 to 15 by every message.";
CM_ SG_ 386 USS_CE3_5_left "The Cross Echo distance左侧间接回波距离";
CM_ SG_ 386 Checksum4_0x182 "Checksum: IDMSB(0x1) XOR IDLSB(0x82) XOR Byte25
XOR Byte26 XOR Byte27 XOR Byte28 XOR Byte29 XOR Byte30 XOR Byte31";
CM_ SG_ 386 USS_CE3_12_left "The Cross Echo distance左侧间接回波距离";
CM_ SG_ 386 USS_CE3_8_left "The Cross Echo distance左侧间接回波距离";
CM_ SG_ 386 USS_CE3_9_left "The Cross Echo distance左侧间接回波距离";
CM_ SG_ 386 USS_CE3_10_left "The Cross Echo distance左侧间接回波距离";
CM_ SG_ 386 Rolling_counter4_0x182 "RollingCounter: used 4bit length signal and the arithmetic is increased from 0 to 15 by every message.";
CM_ SG_ 386 USS_CE3_11_left "The Cross Echo distance左侧间接回波距离";
CM_ SG_ 387 Rolling_counter4_0x183 "RollingCounter: used 4bit length signal and the arithmetic is increased from 0 to 15 by every message.";
CM_ SG_ 387 Checksum4_0x183 "Checksum: IDMSB(0x1) XOR IDLSB(0x83) XOR Byte25
XOR Byte26 XOR Byte27 XOR Byte28 XOR Byte29 XOR Byte30 XOR Byte31";
CM_ SG_ 387 SDW_RR_2SideDistance "SDW Rear Side Right Obstacle Zone右后2侧边障碍物距离";
CM_ SG_ 387 SDW_RL_2SideDistance "SDW Rear Side Left Obstacle Zone左后2侧边障碍物距离";
CM_ SG_ 387 SDW_FR_2SideDistance "SDW Front Side Right Obstacle Zone右前2侧边障碍物距离";
CM_ SG_ 387 SDW_FL_2SideDistance "SDW Front Side Left Obstacle Zone左前2侧边障碍物距离";
CM_ SG_ 387 SDW_RR_1SideDistance "SDW Rear Side Right Obstacle Zone右后侧边障碍物距离";
CM_ SG_ 387 SDW_RL_1SideDistance "SDW Rear Side Left Obstacle Zone左后侧边障碍物距离";
CM_ SG_ 387 SDW_FR_1SideDistance "SDW Front Side Right Obstacle Zone右前侧边障碍物距离";
CM_ SG_ 387 SDW_FL_1SideDistance "SDW Front Side Left Obstacle Zone左前侧边障碍物距离";
CM_ SG_ 387 Rolling_counter3_0x183 "RollingCounter: used 4bit length signal and the arithmetic is increased from 0 to 15 by every message.";
CM_ SG_ 387 Checksum3_0x183 "Checksum: IDMSB(0x1) XOR IDLSB(0x83) XOR Byte17
XOR Byte18 XOR Byte19 XOR Byte20 XOR Byte21 XOR Byte22 XOR Byte23";
CM_ SG_ 387 PAS_RRM_Distance "PAS  Rear Right Middle  Distance of First Segment
倒车雷达右后中区距离显示";
CM_ SG_ 387 PAS_RR_Distance "PAS  Rear Right  Distance of First Segment
倒车雷达右后区距离显示";
CM_ SG_ 387 PAS_RLM_Distance "PAS  Rear Left Middle Distance of First Segment
倒车雷达左后中区距离显示";
CM_ SG_ 387 PAS_RL_Distance "PAS  Rear Left  Distance of First Segment
倒车雷达左后区距离显示";
CM_ SG_ 387 Checksum1_0x183 "Checksum: IDMSB(0x1) XOR IDLSB(0x83) XOR Byte1 XOR Byte2 XOR Byte3 XOR Byte4 XOR Byte5 XOR Byte6 XOR Byte7";
CM_ SG_ 387 PAS_FL_Distance "PAS  Front Left Distance of First Segment
倒车雷达左前区距离显示";
CM_ SG_ 387 PAS_FLM_Distance "PAS  Front Left Middle Distance of First Segment
倒车雷达左前中区距离显示";
CM_ SG_ 387 PAS_FR_Distance "PAS  Front Right  Distance of First Segment
倒车雷达右前区距离显示";
CM_ SG_ 387 PAS_FRM_Distance "PAS  Front Right Middle Distance of First Segment
倒车雷达右前中1 区距离显示";
CM_ SG_ 387 Rolling_counter1_0x183 "RollingCounter: used 4bit length signal and the arithmetic is increased from 0 to 15 by every message.";
CM_ SG_ 387 Checksum2_0x183 "Checksum: IDMSB(0x1) XOR IDLSB(0x83) XOR Byte9
XOR Byte10 XOR Byte11 XOR Byte12 XOR Byte13 XOR Byte14 XOR Byte15";
CM_ SG_ 387 ApaVehX "Vehicle position (x-direction)车辆相对于VHM坐标为原点的X坐标";
CM_ SG_ 387 ApaVehY "Vehicle position (Y-direction)车辆相对于VHM坐标为原点的Y坐标";
CM_ SG_ 387 ApaVehYawAngle "Vehicle position (Y-direction)车辆相对于VHM坐标为原点的横摆角";
CM_ SG_ 387 Rolling_counter2_0x183 "RollingCounter: used 4bit length signal and the arithmetic is increased from 0 to 15 by every message.";
CM_ SG_ 688 RR_2SideAreaScand "Rear Right Side Area Scanned右后2区域被扫瞄";
CM_ SG_ 688 RL_2SideAreaScand "Rear Left Side Area Scanned左后2区域被扫瞄";
CM_ SG_ 688 FR_2SideAreaScand "Front Right Side Area Scanned右前2区域被扫瞄";
CM_ SG_ 688 FL_2SideAreaScand "Front Left Side Area Scanned左前2区域被扫瞄";
CM_ SG_ 688 SDW_RR_2SideDistance_range "SDW Rear Side Right Obstacle Zone右后2侧边障碍物距离范围
range1 0~40cm
range2 40~80cm";
CM_ SG_ 688 SDW_RL_2SideDistance_range "SDW Rear Side Left Obstacle Zone左后2侧边障碍物距离范围
range1 0~40cm
range2 40~80cm";
CM_ SG_ 688 SDW_FR_2SideDistance_range "SDW Front Side Right Obstacle Zone右前2侧边障碍物距离范围
range1 0~40cm
range2 40~80cm";
CM_ SG_ 688 SDW_FL_2SideDistance_range "SDW Front Side Left Obstacle Zone左前2侧边障碍物距离范围
range1 0~40cm
range2 40~80cm";
CM_ SG_ 688 Checksum1_0x2B0 "Checksum: IDMSB(0x2) XOR IDLSB(0xB0) XOR Byte1 XOR Byte2 XOR Byte3 XOR Byte4 XOR Byte5 XOR Byte6 XOR Byte7";
CM_ SG_ 688 PAS_Mode "PAS倒车雷达的工作模式";
CM_ SG_ 688 PASFLDistance_range "Parking Pilot Front Left Segment倒车雷达左前区距离显示
range1 0~40cm
range240~80cm
range3 80~150cm";
CM_ SG_ 688 PASFMRDistance_range "Parking Pilot Front  Middle Right Segment倒车雷达右中前区距离显示
range1 ≤40cm
range2 40~80cm
range3 80~100cm
range4  >100cm (No Object)";
CM_ SG_ 688 PASFMLDistance_range "Parking Pilot Front  Middle Left Segment倒车雷达左中前区距离显示
range1 ≤40cm
range2 40~80cm
range3 80~100cm
range4  >100cm (No Object)";
CM_ SG_ 688 PASRLDistance_range "Parking Pilot Rear Left Segment倒车雷达左后区距离显示
range1 0~40cm
range240~80cm
range3 80~150cm";
CM_ SG_ 688 PASFRDistance_range "Parking Pilot Front  Right Segment倒车雷达右前区距离显示
range1 0~40cm
range240~80cm
range3 80~150cm";
CM_ SG_ 688 PASRMLDistance_range "Parking Pilot Rear Middle Left Segment倒车雷达左中后区距离显示
range1 ≤40cm
range2 40~80cm
range3 80~150cm
range4  >150cm (No Object)";
CM_ SG_ 688 PASRRDistance_range "Parking Pilot Rear right Segment倒车雷达右后区距离显示
range1 0~40cm
range240~80cm
range3 80~150cm";
CM_ SG_ 688 PASWarningType "Parking Pilot Audible Warning Type 蜂鸣器报警信号";
CM_ SG_ 688 PASFailureReason "PAS失效原因";
CM_ SG_ 688 PASRMRDistance_range "Parking Pilot rear  Middle right Segment 倒车雷达右中后区距离显示
range1 ≤40cm
range2 40~80cm
range3 80~150cm
range4  >150cm (No Object)";
CM_ SG_ 688 Rolling_counter1_0x2B0 "RollingCounter: used 4bit length signal and the arithmetic is increased from 0 to 15 by every message.";
CM_ SG_ 688 Checksum2_0x2B0 "Checksum: IDMSB(0x2) XOR IDLSB(0xB0) XOR Byte9 XOR Byte10 XOR Byte11 XOR Byte12 XOR Byte13 XOR Byte14 XOR Byte15";
CM_ SG_ 688 SDW_FL_1SideDistance_range "SDW Front Side Left Obstacle Zone左前侧边障碍物距离
range1 0~40cm
range2 40~80cm";
CM_ SG_ 688 SDW_FR_1SideDistance_range "SDW Front Side Right Obstacle Zone右前侧边障碍物距离
range1 0~40cm
range2 40~80cm";
CM_ SG_ 688 SDW_RL_1SideDistance_range "SDW Rear Side Left Obstacle Zone左后侧边障碍物距离
range1 0~40cm
range2 40~80cm";
CM_ SG_ 688 SDW_RR_1SideDistance_range "SDW Rear Side Right Obstacle Zone右后侧边障碍物距离
range1 0~40cm
range2 40~80cm";
CM_ SG_ 688 FL_1SideAreaScand "Front Left Side Area Scanned左前区域被扫瞄";
CM_ SG_ 688 FR_1SideAreaScand "Front Right Side Area Scanned右前区域被扫瞄";
CM_ SG_ 688 RL_1SideAreaScand "Rear Left Side Area Scanned左后区域被扫瞄";
CM_ SG_ 688 RR_1SideAreaScand "Rear Right Side Area Scanned右后区域被扫瞄";
CM_ SG_ 688 UPC_SDW_WorkMode "UPC SDW (Side Distance Warning) Work Mode
侧边报警功能工作状态";
CM_ SG_ 688 APA_PSLSts "APA Parking Slot Searching Status  IndicationAPA_PSL工作进程";
CM_ SG_ 688 Rolling_counter2_0x2B0 "RollingCounter: used 4bit length signal and the arithmetic is increased from 0 to 15 by every message.";
CM_ BO_ 944 "快照数据相关";
CM_ SG_ 944 TBOX_TimeSyncData_Year "TBOX发送的同步时间数据----年
0x0-0x63: Year
0x64-0x7F: Invalid";
CM_ SG_ 944 TBOX_TimeSyncData_Month "TBOX发送的同步时间数据----月
0x0: Invalid
0x1-0xC: Month";
CM_ SG_ 944 TBOX_TimeSyncData_Day "TBOX发送的同步时间数据----日
0x0: Invalid
0x01-0x1F: Day";
CM_ SG_ 944 TBOX_TimeSyncData_Hour "ACM发送的同步时间数据----时
0x0-0x17: Hour
0x18-0x1F: Invalid";
CM_ SG_ 944 TBOX_TimeSyncData_Minute "TBOX发送的同步时间数据----分
0x0-0x3B: Minute
0x3C-0x3F: Invalid";
CM_ SG_ 944 TBOX_TimeSyncData_Second "TBOX发送的同步时间数据----秒
0x00-0x3B: Second
0x3C-0x3F: Invalid";
CM_ SG_ 944 ICM_ODOTotal "ODO 总里程，
0xF423F~0xFFFFFF: Invalid signal";
CM_ SG_ 1484 PA_SWVersion_Supplier "PA软件供应商代码（有天际定义，如A/B/C分别代表A点/B点/C点供应商，定义参考诊断规范版本号定义）";
CM_ SG_ 1484 PA_SWVersion_Main "PA软件版本-大版本";
CM_ SG_ 1484 PA_SWVersion_Sub1 "PA软件版本-小版本第一位";
CM_ SG_ 1484 PA_SWVersion_Sub2 "PA软件版本-小版本第二位";
CM_ SG_ 1484 PA_HWVersion_Supplier "PA硬件件供应商代码";
CM_ SG_ 1484 PA_HWVersion_Main "PA硬件版本-大版本";
CM_ SG_ 1484 PA_HWVersion_Sub1 "PA硬件版本-小版本第一位";
CM_ SG_ 1484 PA_HWVersion_Sub2 "PA硬件版本-小版本第二位";
CM_ SG_ 1841 PA_UDSDiag_ReqPhsy_0x731 "PA UDS诊断物理寻址ID，数据位根据需求供应商可自定义";
CM_ SG_ 1849 PA_UDSDiag_Resp_0x739 "PA UDS诊断响应ID，数据位根据需求供应商可自定义";
CM_ SG_ 2015 UDSDiag_ReqFunc_0x7DF "整车UDS诊断功能寻址ID，数据位根据需求供应商可自定义";
BA_DEF_ BO_  "DiagState" ENUM  "No","Yes";
BA_DEF_ BO_  "GenMsgSendType" ENUM  "Cyclic","Event","IfActive","CE","CA","NoMsgSendType";
BA_DEF_ BO_  "GenMsgCycleTime" INT 0 0;
BA_DEF_ SG_  "GenSigSendType" ENUM  "Cyclic","OnChange","OnWrite","IfActive","OnChangeWithRepetition","OnWriteWithRepetition","IfActiveWithRepetition","NoSigSendType","OnChangeAndIfActive","OnChangeAndIfActiveWithRepetition","CA","CE","Event";
BA_DEF_ SG_  "GenSigStartValue" INT 0 0;
BA_DEF_  "DBName" STRING ;
BA_DEF_ BO_  "CANFD_BRS" ENUM  "0","1";
BA_DEF_ BO_  "VFrameFormat" ENUM  "StandardCAN","ExtendedCAN","reserved","reserved","reserved","reserved","reserved","reserved","reserved","reserved","reserved","reserved","reserved","reserved","StandardCAN_FD","ExtendedCAN_FD";
BA_DEF_  "NmMessageCount" INT 0 255;
BA_DEF_ BO_  "GenMsgILSupport" ENUM  "No","Yes";
BA_DEF_  "NmBaseAddress" HEX 1024 1087;
BA_DEF_  "BusType" STRING ;
BA_DEF_DEF_  "DiagState" "No";
BA_DEF_DEF_  "GenMsgSendType" "Cyclic";
BA_DEF_DEF_  "GenMsgCycleTime" 0;
BA_DEF_DEF_  "GenSigSendType" "Cyclic";
BA_DEF_DEF_  "GenSigStartValue" 0;
BA_DEF_DEF_  "DBName" "";
BA_DEF_DEF_  "CANFD_BRS" "1";
BA_DEF_DEF_  "VFrameFormat" "StandardCAN_FD";
BA_DEF_DEF_  "NmMessageCount" 128;
BA_DEF_DEF_  "GenMsgILSupport" "Yes";
BA_DEF_DEF_  "NmBaseAddress" 1024;
BA_DEF_DEF_  "BusType" "CAN FD";
BA_ "DBName" "ME5_APSPA_CAN_CMatrix_V202021428";
BA_ "GenMsgCycleTime" BO_ 690 20;
BA_ "GenMsgCycleTime" BO_ 689 20;
BA_ "GenMsgCycleTime" BO_ 389 20;
BA_ "GenMsgCycleTime" BO_ 388 20;
BA_ "GenMsgCycleTime" BO_ 184 10;
BA_ "GenMsgCycleTime" BO_ 336 20;
BA_ "GenMsgCycleTime" BO_ 338 20;
BA_ "GenMsgCycleTime" BO_ 369 20;
BA_ "GenMsgCycleTime" BO_ 370 20;
BA_ "GenMsgCycleTime" BO_ 371 20;
BA_ "GenMsgCycleTime" BO_ 372 20;
BA_ "GenMsgCycleTime" BO_ 375 20;
BA_ "GenMsgCycleTime" BO_ 376 20;
BA_ "GenMsgCycleTime" BO_ 377 20;
BA_ "GenMsgCycleTime" BO_ 378 20;
BA_ "GenMsgCycleTime" BO_ 379 20;
BA_ "GenMsgCycleTime" BO_ 380 20;
BA_ "GenMsgCycleTime" BO_ 381 20;
BA_ "GenMsgCycleTime" BO_ 382 20;
BA_ "GenMsgCycleTime" BO_ 385 20;
BA_ "GenMsgCycleTime" BO_ 386 20;
BA_ "GenMsgCycleTime" BO_ 387 20;
BA_ "GenMsgCycleTime" BO_ 688 100;
BA_ "GenMsgCycleTime" BO_ 944 1000;
BA_ "GenMsgCycleTime" BO_ 1484 10000;
BA_ "VFrameFormat" BO_ 1841 0;
BA_ "CANFD_BRS" BO_ 1841 0;
BA_ "GenMsgSendType" BO_ 1841 1;
BA_ "VFrameFormat" BO_ 1849 0;
BA_ "CANFD_BRS" BO_ 1849 0;
BA_ "GenMsgSendType" BO_ 1849 1;
BA_ "VFrameFormat" BO_ 2015 0;
BA_ "CANFD_BRS" BO_ 2015 0;
BA_ "GenMsgSendType" BO_ 2015 1;
BA_ "DiagState" BO_ 2015 1;
BA_ "GenSigStartValue" SG_ 689 APS_Debug_PathSeg10KPHeading 2047.4025974026;
BA_ "GenSigStartValue" SG_ 689 APS_Debug_PathSeg9KPHeading 2047.4025974026;
BA_ "GenSigStartValue" SG_ 689 APS_Debug_PathSeg8KPHeading 2047.4025974026;
BA_ "GenSigStartValue" SG_ 689 APS_Debug_PathSeg7KPHeading 2047.4025974026;
BA_ "GenSigStartValue" SG_ 689 APS_Debug_PathSeg10KPY 2047;
BA_ "GenSigStartValue" SG_ 689 APS_Debug_PathSeg9KPY 2047;
BA_ "GenSigStartValue" SG_ 689 APS_Debug_PathSeg8KPY 2047;
BA_ "GenSigStartValue" SG_ 689 APS_Debug_PathSeg7KPY 2047;
BA_ "GenSigStartValue" SG_ 689 APS_Debug_PathSeg10KPX 2047;
BA_ "GenSigStartValue" SG_ 689 APS_Debug_PathSeg9KPX 2047;
BA_ "GenSigStartValue" SG_ 689 APS_Debug_PathSeg8KPX 2047;
BA_ "GenSigStartValue" SG_ 689 APS_Debug_PathSeg7KPX 2047;
BA_ "GenSigStartValue" SG_ 689 APS_Debug_PathSeg10CCY 2047;
BA_ "GenSigStartValue" SG_ 689 APS_Debug_PathSeg9CCY 2047;
BA_ "GenSigStartValue" SG_ 689 APS_Debug_PathSeg8CCY 2047;
BA_ "GenSigStartValue" SG_ 689 APS_Debug_PathSeg7CCY 2047;
BA_ "GenSigStartValue" SG_ 689 APS_Debug_PathSeg10CCX 2047;
BA_ "GenSigStartValue" SG_ 689 APS_Debug_PathSeg9CCX 2047;
BA_ "GenSigStartValue" SG_ 689 APS_Debug_PathSeg8CCX 2047;
BA_ "GenSigStartValue" SG_ 689 APS_Debug_PathSeg7CCX 2047;
BA_ "GenSigStartValue" SG_ 389 APS_Debug_PathSeg6KPHeading 2047.4025974026;
BA_ "GenSigStartValue" SG_ 389 APS_Debug_PathSeg5KPHeading 2047.4025974026;
BA_ "GenSigStartValue" SG_ 389 APS_Debug_PathSeg4KPHeading 2047.4025974026;
BA_ "GenSigStartValue" SG_ 389 APS_Debug_PathSeg3KPHeading 2047.4025974026;
BA_ "GenSigStartValue" SG_ 389 APS_Debug_PathSeg6KPY 2047;
BA_ "GenSigStartValue" SG_ 389 APS_Debug_PathSeg5KPY 2047;
BA_ "GenSigStartValue" SG_ 389 APS_Debug_PathSeg4KPY 2047;
BA_ "GenSigStartValue" SG_ 389 APS_Debug_PathSeg3KPY 2047;
BA_ "GenSigStartValue" SG_ 389 APS_Debug_PathSeg6KPX 2047;
BA_ "GenSigStartValue" SG_ 389 APS_Debug_PathSeg5KPX 2047;
BA_ "GenSigStartValue" SG_ 389 APS_Debug_PathSeg4KPX 2047;
BA_ "GenSigStartValue" SG_ 389 APS_Debug_PathSeg3KPX 2047;
BA_ "GenSigStartValue" SG_ 389 APS_Debug_PathSeg6CCY 2047;
BA_ "GenSigStartValue" SG_ 389 APS_Debug_PathSeg5CCY 2047;
BA_ "GenSigStartValue" SG_ 389 APS_Debug_PathSeg4CCY 2047;
BA_ "GenSigStartValue" SG_ 389 APS_Debug_PathSeg3CCY 2047;
BA_ "GenSigStartValue" SG_ 389 APS_Debug_PathSeg6CCX 2047;
BA_ "GenSigStartValue" SG_ 389 APS_Debug_PathSeg5CCX 2047;
BA_ "GenSigStartValue" SG_ 389 APS_Debug_PathSeg3CCX 2047;
BA_ "GenSigStartValue" SG_ 389 APS_Debug_PathSeg4CCX 2047;
BA_ "GenSigStartValue" SG_ 388 APS_Debug_PathSeg2KPHeading 2047.4025974026;
BA_ "GenSigStartValue" SG_ 388 APS_Debug_PathSeg1KPHeading 2047.4025974026;
BA_ "GenSigStartValue" SG_ 388 APS_Debug_PathSeg2KPY 2047;
BA_ "GenSigStartValue" SG_ 388 APS_Debug_PathSeg1KPY 2047;
BA_ "GenSigStartValue" SG_ 388 APS_Debug_PathSeg2KPX 2047;
BA_ "GenSigStartValue" SG_ 388 APS_Debug_PathSeg1KPX 2047;
BA_ "GenSigStartValue" SG_ 388 APS_Debug_PathSeg2CCY 2047;
BA_ "GenSigStartValue" SG_ 388 APS_Debug_PathSeg1CCY 2047;
BA_ "GenSigStartValue" SG_ 388 APS_Debug_PathSeg2CCX 2047;
BA_ "GenSigStartValue" SG_ 388 APS_Debug_PathSeg1CCX 2047;
BA_ "GenSigStartValue" SG_ 388 APS_Debug_PathOriginHeading 2047.4025974026;
BA_ "GenSigStartValue" SG_ 388 APS_Debug_PathOriginY 2047;
BA_ "GenSigStartValue" SG_ 388 APS_Debug_PathOriginX 2047;
BA_ "GenSigStartValue" SG_ 388 APS_Debug_DRHeading 2047.4025974026;
BA_ "GenSigStartValue" SG_ 388 APS_Debug_DRY 2047;
BA_ "GenSigStartValue" SG_ 388 APS_Debug_DRX 2047;
BA_ "GenSigStartValue" SG_ 944 TBOX_TimeSyncData_Month 1;
BA_ "GenSigStartValue" SG_ 944 TBOX_TimeSyncData_Day 1;
BA_ "GenSigSendType" SG_ 1841 PA_UDSDiag_ReqPhsy_0x731 1;
BA_ "GenSigSendType" SG_ 1849 PA_UDSDiag_Resp_0x739 1;
BA_ "GenSigSendType" SG_ 2015 UDSDiag_ReqFunc_0x7DF 1;
VAL_ 3221225472 VBU_VehicleSysFaultLamp 1 "Fault" 0 "No Fault" ;
VAL_ 689 APS_Debug_PathSeg10Dir 3 "Reserved" 2 "Backward" 1 "Forward" 0 "Stop" ;
VAL_ 689 APS_Debug_PathSeg9Dir 3 "Reserved" 2 "Backward" 1 "Forward" 0 "Stop" ;
VAL_ 689 APS_Debug_PathSeg8Dir 3 "Reserved" 2 "Backward" 1 "Forward" 0 "Stop" ;
VAL_ 689 APS_Debug_PathSeg7Dir 3 "Reserved" 2 "Backward" 1 "Forward" 0 "Stop" ;
VAL_ 689 APS_Debug_PathSeg10Type 3 "Reserved" 2 "Sample" 1 "Circle" 0 "Line" ;
VAL_ 689 APS_Debug_PathSeg9Type 3 "Reserved" 2 "Sample" 1 "Circle" 0 "Line" ;
VAL_ 689 APS_Debug_PathSeg8Type 3 "Reserved" 2 "Sample" 1 "Circle" 0 "Line" ;
VAL_ 689 APS_Debug_PathSeg7Type 3 "Reserved" 2 "Sample" 1 "Circle" 0 "Line" ;
VAL_ 389 APS_Debug_PathSeg6Dir 3 "Reserved" 2 "Backward" 1 "Forward" 0 "Stop" ;
VAL_ 389 APS_Debug_PathSeg5Dir 3 "Reserved" 2 "Backward" 1 "Forward" 0 "Stop" ;
VAL_ 389 APS_Debug_PathSeg4Dir 3 "Reserved" 2 "Backward" 1 "Forward" 0 "Stop" ;
VAL_ 389 APS_Debug_PathSeg3Dir 3 "Reserved" 2 "Backward" 1 "Forward" 0 "Stop" ;
VAL_ 389 APS_Debug_PathSeg6Type 3 "Reserved" 2 "Sample" 1 "Circle" 0 "Line" ;
VAL_ 389 APS_Debug_PathSeg5Type 3 "Reserved" 2 "Sample" 1 "Circle" 0 "Line" ;
VAL_ 389 APS_Debug_PathSeg4Type 3 "Reserved" 2 "Sample" 1 "Circle" 0 "Line" ;
VAL_ 389 APS_Debug_PathSeg3Type 3 "Reserved" 2 "Sample" 1 "Circle" 0 "Line" ;
VAL_ 388 APS_Debug_PathSeg2Dir 3 "Reserved" 2 "Backward" 1 "Forward" 0 "Stop" ;
VAL_ 388 APS_Debug_PathSeg1Dir 3 "Reserved" 2 "Backward" 1 "Forward" 0 "Stop" ;
VAL_ 388 APS_Debug_PathSeg2Type 3 "Reserved" 2 "Sample" 1 "Circle" 0 "Line" ;
VAL_ 388 APS_Debug_PathSeg1Type 3 "Reserved" 2 "Sample" 1 "Circle" 0 "Line" ;
VAL_ 184 SAS_SASStsSnsr 1 "sensor value  valid" 0 "sensor value  Invalid" ;
VAL_ 184 SAS_SASStsCal 1 "sensor calibrated" 0 "sensor not calibrated" ;
VAL_ 336 ESP_VehicleSpeed_Valid 1 "Invalid" 0 "Valid" ;
VAL_ 336 ESP_EPBStatus 7 ":Reserved" 6 ":Reserved" 5 ":Reserved" 4 "Locking（卡钳正处于夹紧过程中" 3 "Releasing（卡钳正处于释放过程中）" 2 "Closed（卡钳处于夹紧状态）" 1 "Released（卡钳处于释放状态）" 0 "Undefined（未定义）" ;
VAL_ 336 ESP_VehicleStop 1 "2 or more wheels are standstill" 0 "Vehicle is not standstill" ;
VAL_ 336 ESP_VehicleStop_Valid 1 "Valid" 0 "Invalid" ;
VAL_ 336 ABS_WheelSpeed_FL 4095 "Invalid" ;
VAL_ 336 ABS_WheelSpeed_FR 4095 "Invalid" ;
VAL_ 336 ABS_WheelSpeed_RL 4095 "Invalid" ;
VAL_ 336 ABS_WheelSpeed_RR 4095 "Invalid" ;
VAL_ 336 ABS_WheelSpeed_FL_Valid 1 "Invalid" 0 "Valid" ;
VAL_ 336 ABS_WheelSpeed_FR_Valid 1 "Invalid" 0 "Valid" ;
VAL_ 336 ABS_WheelSpeed_RL_Valid 1 "Invalid" 0 "Valid" ;
VAL_ 336 ABS_WheelSpeed_RR_Valid 1 "Invalid" 0 "Valid" ;
VAL_ 336 ESP_WheelDirection_FL 3 "Backward" 2 "Forward" 1 "Standstill" 0 "Undefined" ;
VAL_ 336 ESP_WheelDirection_FL_Valid 1 "Valid" 0 "Invalid" ;
VAL_ 336 ESP_WheelDirection_FR 3 "Backward" 2 "Forward" 1 "Standstill" 0 "Undefined" ;
VAL_ 336 ESP_WheelDirection_FR_Valid 1 "Valid" 0 "Invalid" ;
VAL_ 336 ESP_WheelDirection_RL 3 "Backward" 2 "Forward" 1 "Standstill" 0 "Undefined" ;
VAL_ 336 ESP_WheelDirection_RL_Valid 1 "Valid" 0 "Invalid" ;
VAL_ 336 ESP_WheelDirection_RR 3 "Backward" 2 "Forward" 1 "Standstill" 0 "Undefined" ;
VAL_ 336 ESP_WheelDirection_RR_Valid 1 "Valid" 0 "Invalid" ;
VAL_ 336 ABS_WheelPulse_FL_Valid 1 "valid" 0 "not valid" ;
VAL_ 336 ABS_WheelPulse_FR_Valid 1 "valid" 0 "not valid" ;
VAL_ 336 ABS_WheelPulse_RL_Valid 1 "valid" 0 "not valid" ;
VAL_ 336 ABS_WheelPulse_RR_Valid 1 "valid" 0 "not valid" ;
VAL_ 338 ESP_YawrateValue_valid 1 "invalid" 0 "valid" ;
VAL_ 338 ESP_LongAccSensorValid 1 "invalid" 0 "valid" ;
VAL_ 338 ESP_LaterAccSensorValid 1 "invalid" 0 "valid" ;
VAL_ 338 GW_VBU_GearLeverPos 7 "Invalid" 6 "Reserved" 5 "Reserved" 4 "Reserved" 3 "D" 2 "N" 1 "R" 0 "P" ;
VAL_ 338 GW_VBU_ReadySts 1 "Ready" 0 "Not Ready" ;
VAL_ 338 GW_BCM_SystemPowerMode 3 "ready" 2 "ON" 1 "Reserved" 0 "OFF" ;
VAL_ 369 ParkslotI_Selected 255 "Invalid" 254 "NoSpace" ;
VAL_ 369 APS_Workingsts 7 "Reserved" 6 "Reserved" 5 "PA Failure" 4 "APS Failure" 3 "Tracking" 2 "Searching" 1 "Standby" 0 "Off" ;
VAL_ 370 MapObj01Type 7 "Invalid" 6 ":Reserved" 5 ":Reserved" 4 "Straight2Corner" 3 "Straight1Corner" 2 "Straight0Corner" 1 "Point" 0 "None" ;
VAL_ 370 MapObj01Prob 7 "Invalid" ;
VAL_ 370 MapObj01P1X 1023 "Invalid" ;
VAL_ 370 MapObj01HeightProb 7 "Invalid" ;
VAL_ 370 MapObj01P1Y 1023 "Invalid" ;
VAL_ 370 MapObj01P2X 1023 "Invalid" ;
VAL_ 370 MapObj01Height 3 "Unknown" 2 "Traversible" 1 "High" 0 "Low" ;
VAL_ 370 MapObj01P2Y 1023 "Invalid" ;
VAL_ 370 MapObj02Type 7 "Invalid" 6 ":Reserved" 5 ":Reserved" 4 "Straight2Corner" 3 "Straight1Corner" 2 "Straight0Corner" 1 "Point" 0 "None" ;
VAL_ 370 MapObj02Prob 7 "Invalid" ;
VAL_ 370 MapObj02P1X 1023 "Invalid" ;
VAL_ 370 MapObj02HeightProb 7 "Invalid" ;
VAL_ 370 MapObj02P1Y 1023 "Invalid" ;
VAL_ 370 MapObj02P2X 1023 "Invalid" ;
VAL_ 370 MapObj02Height 3 "Unknown" 2 "Traversible" 1 "High" 0 "Low" ;
VAL_ 370 MapObj02P2Y 1023 "Invalid" ;
VAL_ 370 MapObj03Type 7 "Invalid" 6 ":Reserved" 5 ":Reserved" 4 "Straight2Corner" 3 "Straight1Corner" 2 "Straight0Corner" 1 "Point" 0 "None" ;
VAL_ 370 MapObj03Prob 7 "Invalid" ;
VAL_ 370 MapObj03P1X 1023 "Invalid" ;
VAL_ 370 MapObj03HeightProb 7 "Invalid" ;
VAL_ 370 MapObj03P1Y 1023 "Invalid" ;
VAL_ 370 MapObj03P2X 1023 "Invalid" ;
VAL_ 370 MapObj03Height 3 "Unknown" 2 "Traversible" 1 "High" 0 "Low" ;
VAL_ 370 MapObj03P2Y 1023 "Invalid" ;
VAL_ 370 MapObj04Type 7 "Invalid" 6 ":Reserved" 5 ":Reserved" 4 "Straight2Corner" 3 "Straight1Corner" 2 "Straight0Corner" 1 "Point" 0 "None" ;
VAL_ 370 MapObj04Prob 7 "Invalid" ;
VAL_ 370 MapObj04P1X 1023 "Invalid" ;
VAL_ 370 MapObj04HeightProb 7 "Invalid" ;
VAL_ 370 MapObj04P1Y 1023 "Invalid" ;
VAL_ 370 MapObj04P2X 1023 "Invalid" ;
VAL_ 370 MapObj04Height 3 "Unknown" 2 "Traversible" 1 "High" 0 "Low" ;
VAL_ 370 MapObj04P2Y 1023 "Invalid" ;
VAL_ 371 MapObj05Type 7 "Invalid" 6 ":Reserved" 5 ":Reserved" 4 "Straight2Corner" 3 "Straight1Corner" 2 "Straight0Corner" 1 "Point" 0 "None" ;
VAL_ 371 MapObj05Prob 7 "Invalid" ;
VAL_ 371 MapObj05P1X 1023 "Invalid" ;
VAL_ 371 MapObj05HeightProb 7 "Invalid" ;
VAL_ 371 MapObj05P1Y 1023 "Invalid" ;
VAL_ 371 MapObj05P2X 1023 "Invalid" ;
VAL_ 371 MapObj05Height 3 "Unknown" 2 "Traversible" 1 "High" 0 "Low" ;
VAL_ 371 MapObj05P2Y 1023 "Invalid" ;
VAL_ 371 MapObj06Type 7 "Invalid" 6 ":Reserved" 5 ":Reserved" 4 "Straight2Corner" 3 "Straight1Corner" 2 "Straight0Corner" 1 "Point" 0 "None" ;
VAL_ 371 MapObj06Prob 7 "Invalid" ;
VAL_ 371 MapObj06P1X 1023 "Invalid" ;
VAL_ 371 MapObj06HeightProb 7 "Invalid" ;
VAL_ 371 MapObj06P1Y 1023 "Invalid" ;
VAL_ 371 MapObj06P2X 1023 "Invalid" ;
VAL_ 371 MapObj06Height 3 "Unknown" 2 "Traversible" 1 "High" 0 "Low" ;
VAL_ 371 MapObj06P2Y 1023 "Invalid" ;
VAL_ 371 MapObj07Type 7 "Invalid" 6 ":Reserved" 5 ":Reserved" 4 "Straight2Corner" 3 "Straight1Corner" 2 "Straight0Corner" 1 "Point" 0 "None" ;
VAL_ 371 MapObj07Prob 7 "Invalid" ;
VAL_ 371 MapObj07P1X 1023 "Invalid" ;
VAL_ 371 MapObj07HeightProb 7 "Invalid" ;
VAL_ 371 MapObj07P1Y 1023 "Invalid" ;
VAL_ 371 MapObj07P2X 1023 "Invalid" ;
VAL_ 371 MapObj07Height 3 "Unknown" 2 "Traversible" 1 "High" 0 "Low" ;
VAL_ 371 MapObj07P2Y 1023 "Invalid" ;
VAL_ 371 MapObj08Type 7 "Invalid" 6 ":Reserved" 5 ":Reserved" 4 "Straight2Corner" 3 "Straight1Corner" 2 "Straight0Corner" 1 "Point" 0 "None" ;
VAL_ 371 MapObj08Prob 7 "Invalid" ;
VAL_ 371 MapObj08P1X 1023 "Invalid" ;
VAL_ 371 MapObj08HeightProb 7 "Invalid" ;
VAL_ 371 MapObj08P1Y 1023 "Invalid" ;
VAL_ 371 MapObj08P2X 1023 "Invalid" ;
VAL_ 371 MapObj08Height 3 "Unknown" 2 "Traversible" 1 "High" 0 "Low" ;
VAL_ 371 MapObj08P2Y 1023 "Invalid" ;
VAL_ 372 MapObj09Type 7 "Invalid" 6 ":Reserved" 5 ":Reserved" 4 "Straight2Corner" 3 "Straight1Corner" 2 "Straight0Corner" 1 "Point" 0 "None" ;
VAL_ 372 MapObj09Prob 7 "Invalid" ;
VAL_ 372 MapObj09P1X 1023 "Invalid" ;
VAL_ 372 MapObj09HeightProb 7 "Invalid" ;
VAL_ 372 MapObj09P1Y 1023 "Invalid" ;
VAL_ 372 MapObj09P2X 1023 "Invalid" ;
VAL_ 372 MapObj09Height 3 "Unknown" 2 "Traversible" 1 "High" 0 "Low" ;
VAL_ 372 MapObj09P2Y 1023 "Invalid" ;
VAL_ 372 MapObj10Type 7 "Invalid" 6 ":Reserved" 5 ":Reserved" 4 "Straight2Corner" 3 "Straight1Corner" 2 "Straight0Corner" 1 "Point" 0 "None" ;
VAL_ 372 MapObj10Prob 7 "Invalid" ;
VAL_ 372 MapObj10P1X 1023 "Invalid" ;
VAL_ 372 MapObj10HeightProb 7 "Invalid" ;
VAL_ 372 MapObj10P1Y 1023 "Invalid" ;
VAL_ 372 MapObj10P2X 1023 "Invalid" ;
VAL_ 372 MapObj10Height 3 "Unknown" 2 "Traversible" 1 "High" 0 "Low" ;
VAL_ 372 MapObj10P2Y 1023 "Invalid" ;
VAL_ 372 MapObj11Type 7 "Invalid" 6 ":Reserved" 5 ":Reserved" 4 "Straight2Corner" 3 "Straight1Corner" 2 "Straight0Corner" 1 "Point" 0 "None" ;
VAL_ 372 MapObj11Prob 7 "Invalid" ;
VAL_ 372 MapObj11P1X 1023 "Invalid" ;
VAL_ 372 MapObj11HeightProb 7 "Invalid" ;
VAL_ 372 MapObj11P1Y 1023 "Invalid" ;
VAL_ 372 MapObj11P2X 1023 "Invalid" ;
VAL_ 372 MapObj11Height 3 "Unknown" 2 "Traversible" 1 "High" 0 "Low" ;
VAL_ 372 MapObj11P2Y 1023 "Invalid" ;
VAL_ 372 MapObj12Type 7 "Invalid" 6 ":Reserved" 5 ":Reserved" 4 "Straight2Corner" 3 "Straight1Corner" 2 "Straight0Corner" 1 "Point" 0 "None" ;
VAL_ 372 MapObj12Prob 7 "Invalid" ;
VAL_ 372 MapObj12P1X 1023 "Invalid" ;
VAL_ 372 MapObj12HeightProb 7 "Invalid" ;
VAL_ 372 MapObj12P1Y 1023 "Invalid" ;
VAL_ 372 MapObj12P2X 1023 "Invalid" ;
VAL_ 372 MapObj12Height 3 "Unknown" 2 "Traversible" 1 "High" 0 "Low" ;
VAL_ 372 MapObj12P2Y 1023 "Invalid" ;
VAL_ 375 MapObj13Type 7 "Invalid" 6 ":Reserved" 5 ":Reserved" 4 "Straight2Corner" 3 "Straight1Corner" 2 "Straight0Corner" 1 "Point" 0 "None" ;
VAL_ 375 MapObj13Prob 7 "Invalid" ;
VAL_ 375 MapObj13P1X 1023 "Invalid" ;
VAL_ 375 MapObj13HeightProb 7 "Invalid" ;
VAL_ 375 MapObj13P1Y 1023 "Invalid" ;
VAL_ 375 MapObj13P2X 1023 "Invalid" ;
VAL_ 375 MapObj13Height 3 "Unknown" 2 "Traversible" 1 "High" 0 "Low" ;
VAL_ 375 MapObj13P2Y 1023 "Invalid" ;
VAL_ 375 MapObj14Type 7 "Invalid" 6 ":Reserved" 5 ":Reserved" 4 "Straight2Corner" 3 "Straight1Corner" 2 "Straight0Corner" 1 "Point" 0 "None" ;
VAL_ 375 MapObj14Prob 7 "Invalid" ;
VAL_ 375 MapObj14P1X 1023 "Invalid" ;
VAL_ 375 MapObj14HeightProb 7 "Invalid" ;
VAL_ 375 MapObj14P1Y 1023 "Invalid" ;
VAL_ 375 MapObj14P2X 1023 "Invalid" ;
VAL_ 375 MapObj14Height 3 "Unknown" 2 "Traversible" 1 "High" 0 "Low" ;
VAL_ 375 MapObj14P2Y 1023 "Invalid" ;
VAL_ 375 MapObj15Type 7 "Invalid" 6 ":Reserved" 5 ":Reserved" 4 "Straight2Corner" 3 "Straight1Corner" 2 "Straight0Corner" 1 "Point" 0 "None" ;
VAL_ 375 MapObj15Prob 7 "Invalid" ;
VAL_ 375 MapObj15P1X 1023 "Invalid" ;
VAL_ 375 MapObj15HeightProb 7 "Invalid" ;
VAL_ 375 MapObj15P1Y 1023 "Invalid" ;
VAL_ 375 MapObj15P2X 1023 "Invalid" ;
VAL_ 375 MapObj15Height 3 "Unknown" 2 "Traversible" 1 "High" 0 "Low" ;
VAL_ 375 MapObj15P2Y 1023 "Invalid" ;
VAL_ 375 MapObj16Type 7 "Invalid" 6 ":Reserved" 5 ":Reserved" 4 "Straight2Corner" 3 "Straight1Corner" 2 "Straight0Corner" 1 "Point" 0 "None" ;
VAL_ 375 MapObj16Prob 7 "Invalid" ;
VAL_ 375 MapObj16P1X 1023 "Invalid" ;
VAL_ 375 MapObj16HeightProb 7 "Invalid" ;
VAL_ 375 MapObj16P1Y 1023 "Invalid" ;
VAL_ 375 MapObj16P2X 1023 "Invalid" ;
VAL_ 375 MapObj16Height 3 "Unknown" 2 "Traversible" 1 "High" 0 "Low" ;
VAL_ 375 MapObj16P2Y 1023 "Invalid" ;
VAL_ 376 MapObj17Type 7 "Invalid" 6 ":Reserved" 5 ":Reserved" 4 "Straight2Corner" 3 "Straight1Corner" 2 "Straight0Corner" 1 "Point" 0 "None" ;
VAL_ 376 MapObj17Prob 7 "Invalid" ;
VAL_ 376 MapObj17P1X 1023 "Invalid" ;
VAL_ 376 MapObj17HeightProb 7 "Invalid" ;
VAL_ 376 MapObj17P1Y 1023 "Invalid" ;
VAL_ 376 MapObj17P2X 1023 "Invalid" ;
VAL_ 376 MapObj17Height 3 "Unknown" 2 "Traversible" 1 "High" 0 "Low" ;
VAL_ 376 MapObj17P2Y 1023 "Invalid" ;
VAL_ 376 MapObj18Type 7 "Invalid" 6 ":Reserved" 5 ":Reserved" 4 "Straight2Corner" 3 "Straight1Corner" 2 "Straight0Corner" 1 "Point" 0 "None" ;
VAL_ 376 MapObj18Prob 7 "Invalid" ;
VAL_ 376 MapObj18P1X 1023 "Invalid" ;
VAL_ 376 MapObj18HeightProb 7 "Invalid" ;
VAL_ 376 MapObj18P1Y 1023 "Invalid" ;
VAL_ 376 MapObj18P2X 1023 "Invalid" ;
VAL_ 376 MapObj18Height 3 "Unknown" 2 "Traversible" 1 "High" 0 "Low" ;
VAL_ 376 MapObj18P2Y 1023 "Invalid" ;
VAL_ 376 MapObj19Type 7 "Invalid" 6 ":Reserved" 5 ":Reserved" 4 "Straight2Corner" 3 "Straight1Corner" 2 "Straight0Corner" 1 "Point" 0 "None" ;
VAL_ 376 MapObj19Prob 7 "Invalid" ;
VAL_ 376 MapObj19P1X 1023 "Invalid" ;
VAL_ 376 MapObj19HeightProb 7 "Invalid" ;
VAL_ 376 MapObj19P1Y 1023 "Invalid" ;
VAL_ 376 MapObj19P2X 1023 "Invalid" ;
VAL_ 376 MapObj19Height 3 "Unknown" 2 "Traversible" 1 "High" 0 "Low" ;
VAL_ 376 MapObj19P2Y 1023 "Invalid" ;
VAL_ 376 MapObj20Type 7 "Invalid" 6 ":Reserved" 5 ":Reserved" 4 "Straight2Corner" 3 "Straight1Corner" 2 "Straight0Corner" 1 "Point" 0 "None" ;
VAL_ 376 MapObj20Prob 7 "Invalid" ;
VAL_ 376 MapObj20P1X 1023 "Invalid" ;
VAL_ 376 MapObj20HeightProb 7 "Invalid" ;
VAL_ 376 MapObj20P1Y 1023 "Invalid" ;
VAL_ 376 MapObj20P2X 1023 "Invalid" ;
VAL_ 376 MapObj20Height 3 "Unknown" 2 "Traversible" 1 "High" 0 "Low" ;
VAL_ 376 MapObj20P2Y 1023 "Invalid" ;
VAL_ 377 ParkLeftslot0ID 255 "Invalid" ;
VAL_ 377 ApaPscLeftSlot0Obj1X 2047 "Invalid" 2046 "NoSpace" ;
VAL_ 377 ApaPscLeftSlot0Obj1Y 2047 "Invalid" 2046 "NoSpace" ;
VAL_ 377 ApaPscLeftSlot0Obj2X 2047 "Invalid" 2046 "NoSpace" ;
VAL_ 377 ApaPscLeftSlot0Obj2Y 2047 "Invalid" 2046 "NoSpace" ;
VAL_ 377 ApaPscLeftSlot0Obj1Alpha 127 "Invalid" 126 "NoSpace" ;
VAL_ 377 ApaPscLeftSlot0Obj2Alpha 127 "Invalid" 126 "NoSpace" ;
VAL_ 377 ApaPsc_LeftPSL0_Depth 255 "Invalid" 254 "NoSpace" ;
VAL_ 377 ApaPscLeftSlot0Tpye 7 "Invalid" 6 "RightDiagonal" 5 "LeftDiagonal" 4 "RightCross" 3 "LeftCross" 2 "RightParallel" 1 "LeftParallel" 0 "None" ;
VAL_ 377 ApaPsc_LeftPSL0_Length 511 "Invalid" 510 "NoSpace" ;
VAL_ 377 ApaPsc_LeftPSL0_ObjectType 7 "Reserved" 6 "Unknow" 5 "High" 4 "Low" 3 "Virtual" 2 "Wall" 1 "Curb" 0 "None" ;
VAL_ 377 ParkLeftslot1ID 255 "Invalid" ;
VAL_ 377 ApaPscLeftSlot1Obj1X 2047 "Invalid" 2046 "NoSpace" ;
VAL_ 377 ApaPscLeftSlot1Obj1Y 2047 "Invalid" 2046 "NoSpace" ;
VAL_ 377 ApaPscLeftSlot1Obj2X 2047 "Invalid" 2046 "NoSpace" ;
VAL_ 377 ApaPscLeftSlot1Obj2Y 2047 "Invalid" 2046 "NoSpace" ;
VAL_ 377 ApaPscLeftSlot1Obj1Alpha 127 "Invalid" 126 "NoSpace" ;
VAL_ 377 ApaPscLeftSlot1Obj2Alpha 127 "Invalid" 126 "NoSpace" ;
VAL_ 377 ApaPsc_LeftPSL1_Depth 255 "Invalid" 254 "NoSpace" ;
VAL_ 377 ApaPscLeftSlot1Tpye 7 "Invalid" 6 "RightDiagonal" 5 "LeftDiagonal" 4 "RightCross" 3 "LeftCross" 2 "RightParallel" 1 "LeftParallel" 0 "None" ;
VAL_ 377 ApaPsc_LeftPSL1_Length 511 "Invalid" 510 "NoSpace" ;
VAL_ 377 ApaPsc_LeftPSL1_ObjectType 7 "Reserved" 6 "Unknow" 5 "High" 4 "Low" 3 "Virtual" 2 "Wall" 1 "Curb" 0 "None" ;
VAL_ 378 ParkRightslot0ID 255 "Invalid" ;
VAL_ 378 ApaPscRightSlot0Obj1X 2047 "Invalid" 2046 "NoSpace" ;
VAL_ 378 ApaPscRightSlot0Obj1Y 2047 "Invalid" 2046 "NoSpace" ;
VAL_ 378 ApaPscRightSlot0Obj2X 2047 "Invalid" 2046 "NoSpace" ;
VAL_ 378 ApaPscRightSlot0Obj2Y 2047 "Invalid" 2046 "NoSpace" ;
VAL_ 378 ApaPscRightSlot0Obj1Alpha 127 "Invalid" 126 "NoSpace" ;
VAL_ 378 ApaPscRightSlot0Obj2Alpha 127 "Invalid" 126 "NoSpace" ;
VAL_ 378 ApaPsc_RightPSL0_Depth 255 "Invalid" 254 "NoSpace" ;
VAL_ 378 ApaPscRightSlot0Tpye 7 "Invalid" 6 "RightDiagonal" 5 "LeftDiagonal" 4 "RightCross" 3 "LeftCross" 2 "RightParallel" 1 "LeftParallel" 0 "None" ;
VAL_ 378 ApaPsc_RightPSL0_Length 511 "Invalid" 510 "NoSpace" ;
VAL_ 378 ApaPsc_RightPSL0_ObjectType 7 "Reserved" 6 "Unknow" 5 "High" 4 "Low" 3 "Virtual" 2 "Wall" 1 "Curb" 0 "None" ;
VAL_ 378 ParkRightslot1ID 255 "Invalid" ;
VAL_ 378 ApaPscRightSlot1Obj1X 2047 "Invalid" 2046 "NoSpace" ;
VAL_ 378 ApaPscRightSlot1Obj1Y 2047 "Invalid" 2046 "NoSpace" ;
VAL_ 378 ApaPscRightSlot1Obj2X 2047 "Invalid" 2046 "NoSpace" ;
VAL_ 378 ApaPscRightSlot1Obj2Y 2047 "Invalid" 2046 "NoSpace" ;
VAL_ 378 ApaPscRightSlot1Obj1Alpha 127 "Invalid" 126 "NoSpace" ;
VAL_ 378 ApaPscRightSlot1Obj2Alpha 127 "Invalid" 126 "NoSpace" ;
VAL_ 378 ApaPsc_RightPSL1_Depth 255 "Invalid" 254 "NoSpace" ;
VAL_ 378 ApaPscRightSlot1Tpye 7 "Invalid" 6 "RightDiagonal" 5 "LeftDiagonal" 4 "RightCross" 3 "LeftCross" 2 "RightParallel" 1 "LeftParallel" 0 "None" ;
VAL_ 378 ApaPsc_RightPSL1_Length 511 "Invalid" 510 "NoSpace" ;
VAL_ 378 ApaPsc_RightPSL1_ObjectType 7 "Reserved" 6 "Unknow" 5 "High" 4 "Low" 3 "Virtual" 2 "Wall" 1 "Curb" 0 "None" ;
VAL_ 379 USS_DE1_2 1023 "Invalid" ;
VAL_ 379 USS_DE1_3 1023 "Invalid" ;
VAL_ 379 USS_DE1_4 1023 "Invalid" ;
VAL_ 379 USS_DE1_5 1023 "Invalid" ;
VAL_ 379 USS_DE1_8 1023 "Invalid" ;
VAL_ 379 USS_DE1_9 1023 "Invalid" ;
VAL_ 379 USS_DE1_10 1023 "Invalid" ;
VAL_ 379 USS_DE1_11 1023 "Invalid" ;
VAL_ 379 USS_DE1_1 1023 "Invalid" ;
VAL_ 379 USS_DE1_6 1023 "Invalid" ;
VAL_ 379 USS_DE1_7 1023 "Invalid" ;
VAL_ 379 USS_DE1_12 1023 "Invalid" ;
VAL_ 380 USS_CE1_1_right 1023 "Invalid" ;
VAL_ 380 USS_CE1_2_right 1023 "Invalid" ;
VAL_ 380 USS_CE1_3_right 1023 "Invalid" ;
VAL_ 380 USS_CE1_4_right 1023 "Invalid" ;
VAL_ 380 USS_CE1_5_right 1023 "Invalid" ;
VAL_ 380 USS_CE1_7_right 1023 "Invalid" ;
VAL_ 380 USS_CE1_8_right 1023 "Invalid" ;
VAL_ 380 USS_CE1_9_right 1023 "Invalid" ;
VAL_ 380 USS_CE1_10_right 1023 "Invalid" ;
VAL_ 380 USS_CE1_11_right 1023 "Invalid" ;
VAL_ 380 USS_CE1_2_left 1023 "Invalid" ;
VAL_ 380 USS_CE1_3_left 1023 "Invalid" ;
VAL_ 380 USS_CE1_4_left 1023 "Invalid" ;
VAL_ 380 USS_CE1_5_left 1023 "Invalid" ;
VAL_ 380 USS_CE1_6_left 1023 "Invalid" ;
VAL_ 380 USS_CE1_8_left 1023 "Invalid" ;
VAL_ 380 USS_CE1_9_left 1023 "Invalid" ;
VAL_ 380 USS_CE1_10_left 1023 "Invalid" ;
VAL_ 380 USS_CE1_11_left 1023 "Invalid" ;
VAL_ 380 USS_CE1_12_left 1023 "Invalid" ;
VAL_ 381 USS_DE2_2 1023 "Invalid" ;
VAL_ 381 USS_DE2_3 1023 "Invalid" ;
VAL_ 381 USS_DE2_4 1023 "Invalid" ;
VAL_ 381 USS_DE2_5 1023 "Invalid" ;
VAL_ 381 USS_DE2_8 1023 "Invalid" ;
VAL_ 381 USS_DE2_9 1023 "Invalid" ;
VAL_ 381 USS_DE2_10 1023 "Invalid" ;
VAL_ 381 USS_DE2_11 1023 "Invalid" ;
VAL_ 381 USS_DE2_1 1023 "Invalid" ;
VAL_ 381 USS_DE2_6 1023 "Invalid" ;
VAL_ 381 USS_DE2_7 1023 "Invalid" ;
VAL_ 381 USS_DE2_12 1023 "Invalid" ;
VAL_ 382 USS_CE2_1_right 1023 "Invalid" ;
VAL_ 382 USS_CE2_2_right 1023 "Invalid" ;
VAL_ 382 USS_CE2_3_right 1023 "Invalid" ;
VAL_ 382 USS_CE2_4_right 1023 "Invalid" ;
VAL_ 382 USS_CE2_5_right 1023 "Invalid" ;
VAL_ 382 USS_CE2_7_right 1023 "Invalid" ;
VAL_ 382 USS_CE2_8_right 1023 "Invalid" ;
VAL_ 382 USS_CE2_9_right 1023 "Invalid" ;
VAL_ 382 USS_CE2_10_right 1023 "Invalid" ;
VAL_ 382 USS_CE2_11_right 1023 "Invalid" ;
VAL_ 382 USS_CE2_6_left 1023 "Invalid" ;
VAL_ 382 USS_CE2_2_left 1023 "Invalid" ;
VAL_ 382 USS_CE2_3_left 1023 "Invalid" ;
VAL_ 382 USS_CE2_4_left 1023 "Invalid" ;
VAL_ 382 USS_CE2_5_left 1023 "Invalid" ;
VAL_ 382 USS_CE2_12_left 1023 "Invalid" ;
VAL_ 382 USS_CE2_8_left 1023 "Invalid" ;
VAL_ 382 USS_CE2_9_left 1023 "Invalid" ;
VAL_ 382 USS_CE2_10_left 1023 "Invalid" ;
VAL_ 382 USS_CE2_11_left 1023 "Invalid" ;
VAL_ 385 USS_DE3_2 1023 "Invalid" ;
VAL_ 385 USS_DE3_3 1023 "Invalid" ;
VAL_ 385 USS_DE3_4 1023 "Invalid" ;
VAL_ 385 USS_DE3_5 1023 "Invalid" ;
VAL_ 385 USS_DE3_8 1023 "Invalid" ;
VAL_ 385 USS_DE3_9 1023 "Invalid" ;
VAL_ 385 USS_DE3_10 1023 "Invalid" ;
VAL_ 385 USS_DE3_11 1023 "Invalid" ;
VAL_ 385 USS_DE3_1 1023 "Invalid" ;
VAL_ 385 USS_DE3_6 1023 "Invalid" ;
VAL_ 385 USS_DE3_7 1023 "Invalid" ;
VAL_ 385 USS_DE3_12 1023 "Invalid" ;
VAL_ 386 USS_CE3_1_right 1023 "Invalid" ;
VAL_ 386 USS_CE3_2_right 1023 "Invalid" ;
VAL_ 386 USS_CE3_3_right 1023 "Invalid" ;
VAL_ 386 USS_CE3_4_right 1023 "Invalid" ;
VAL_ 386 USS_CE3_5_right 1023 "Invalid" ;
VAL_ 386 USS_CE3_7_right 1023 "Invalid" ;
VAL_ 386 USS_CE3_8_right 1023 "Invalid" ;
VAL_ 386 USS_CE3_9_right 1023 "Invalid" ;
VAL_ 386 USS_CE3_10_right 1023 "Invalid" ;
VAL_ 386 USS_CE3_11_right 1023 "Invalid" ;
VAL_ 386 USS_CE3_6_left 1023 "Invalid" ;
VAL_ 386 USS_CE3_2_left 1023 "Invalid" ;
VAL_ 386 USS_CE3_3_left 1023 "Invalid" ;
VAL_ 386 USS_CE3_4_left 1023 "Invalid" ;
VAL_ 386 USS_CE3_5_left 1023 "Invalid" ;
VAL_ 386 USS_CE3_12_left 1023 "Invalid" ;
VAL_ 386 USS_CE3_8_left 1023 "Invalid" ;
VAL_ 386 USS_CE3_9_left 1023 "Invalid" ;
VAL_ 386 USS_CE3_10_left 1023 "Invalid" ;
VAL_ 386 USS_CE3_11_left 1023 "Invalid" ;
VAL_ 387 SDW_RR_2SideDistance 255 "Invalid" 254 "No object" ;
VAL_ 387 SDW_RL_2SideDistance 255 "Invalid" 254 "No object" ;
VAL_ 387 SDW_FR_2SideDistance 255 "Invalid" 254 "No object" ;
VAL_ 387 SDW_FL_2SideDistance 255 "Invalid" 254 "No object" ;
VAL_ 387 SDW_RR_1SideDistance 255 "Invalid" 254 "No object" ;
VAL_ 387 SDW_RL_1SideDistance 255 "Invalid" 254 "No object" ;
VAL_ 387 SDW_FR_1SideDistance 255 "Invalid" 254 "No object" ;
VAL_ 387 SDW_FL_1SideDistance 255 "Invalid" 254 "No object" ;
VAL_ 387 PAS_RRM_Distance 255 "Invalid" 254 "No object" 0 "0" ;
VAL_ 387 PAS_RR_Distance 255 "Invalid" 254 "No object" 0 "0" ;
VAL_ 387 PAS_RLM_Distance 255 "Invalid" 254 "No object" 0 "0" ;
VAL_ 387 PAS_RL_Distance 255 "Invalid" 254 "No object" 0 "0" ;
VAL_ 387 PAS_FL_Distance 255 "Invalid" 254 "No object" 0 "0" ;
VAL_ 387 PAS_FLM_Distance 255 "Invalid" 254 "No object" 0 "0" ;
VAL_ 387 PAS_FR_Distance 255 "Invalid" 254 "No object" 0 "0" ;
VAL_ 387 PAS_FRM_Distance 255 "Invalid" 254 "No object" 0 "0" ;
VAL_ 688 RR_2SideAreaScand 1 "True" 0 "False" ;
VAL_ 688 RL_2SideAreaScand 1 "True" 0 "False" ;
VAL_ 688 FR_2SideAreaScand 1 "True" 0 "False" ;
VAL_ 688 FL_2SideAreaScand 1 "True" 0 "False" ;
VAL_ 688 SDW_RR_2SideDistance_range 3 "Reserved" 2 "Range 2" 1 "Range 1" 0 "No obstacle" ;
VAL_ 688 SDW_RL_2SideDistance_range 3 "Reserved" 2 "Range 2" 1 "Range 1" 0 "No obstacle" ;
VAL_ 688 SDW_FR_2SideDistance_range 3 "Reserved" 2 "Range 2" 1 "Range 1" 0 "No obstacle" ;
VAL_ 688 SDW_FL_2SideDistance_range 3 "Reserved" 2 "Range 2" 1 "Range 1" 0 "No obstacle" ;
VAL_ 688 PAS_Mode 15 "Reserved" 14 "Reserved" 13 "Reserved" 12 "Reserved" 11 "Rear failure and Front inactive(Reserved)" 10 "Front failure and Rear inactive" 9 "SystemFailure" 8 "FrontRearActive" 7 "RearActiveAndFrontFailure" 6 "RearActive(Reserved)" 5 "FrontActiveAndRearFailure" 4 "FrontActive" 3 "StandbyAndRearFailure(Reserved)" 2 "StandbyAndFrontFailure(Reserved)" 1 "Standby" 0 "Off" ;
VAL_ 688 PASFLDistance_range 7 "Reserved" 6 "Reserved" 5 "Reserved" 4 "Reserved" 3 "Range 3(No Object)" 2 "Range 2" 1 "Range 1" 0 "Default" ;
VAL_ 688 PASFMRDistance_range 7 "Reserved" 6 "Reserved" 5 "Reserved" 4 "Range 4(No Object)" 3 "Range 3" 2 "Range 2" 1 "Range 1" 0 "Default" ;
VAL_ 688 PASFMLDistance_range 7 "Reserved" 6 "Reserved" 5 "Reserved" 4 "Range 4(No Object)" 3 "Range 3" 2 "Range 2" 1 "Range 1" 0 "Default" ;
VAL_ 688 PASRLDistance_range 7 "Reserved" 6 "Reserved" 5 "Reserved" 4 "Reserved" 3 "Range 3(No Object)" 2 "Range 2" 1 "Range 1" 0 "Default" ;
VAL_ 688 PASFRDistance_range 7 "Reserved" 6 "Reserved" 5 "Reserved" 4 "Reserved" 3 "Range 3(No Object)" 2 "Range 2" 1 "Range 1" 0 "Default" ;
VAL_ 688 PASRMLDistance_range 7 "Reserved" 6 "Reserved" 5 "Reserved" 4 "Range 4(No Object)" 3 "Range 3" 2 "Range 2" 1 "Range 1" 0 "No Distance" ;
VAL_ 688 PASRRDistance_range 7 "Reserved" 6 "Reserved" 5 "Reserved" 4 "Reserved" 3 "Range 3(No Object)" 2 "Range 2" 1 "Range 1" 0 "Default" ;
VAL_ 688 PASWarningType 7 "Reserved" 6 "Reserved" 5 "Reserved" 4 "Buzzer ON at 1Hz" 3 "Buzzer ON at 4Hz" 2 "Buzzer ON at 8Hz" 1 "Buzzer On" 0 "no object" ;
VAL_ 688 PASFailureReason 3 "reserved" 2 "Other reason" 1 "Sensor blindness" 0 "No failure" ;
VAL_ 688 PASRMRDistance_range 7 "Reserved" 6 "Reserved" 5 "Reserved" 4 "Range 4(No Object)" 3 "Range 3" 2 "Range 2" 1 "Range 1" 0 "Default" ;
VAL_ 688 SDW_FL_1SideDistance_range 3 "Reserved" 2 "Range 2" 1 "Range 1" 0 "No obstacle" ;
VAL_ 688 SDW_FR_1SideDistance_range 3 "Reserved" 2 "Range 2" 1 "Range 1" 0 "No obstacle" ;
VAL_ 688 SDW_RL_1SideDistance_range 3 "Reserved" 2 "Range 2" 1 "Range 1" 0 "No obstacle" ;
VAL_ 688 SDW_RR_1SideDistance_range 3 "Reserved" 2 "Range 2" 1 "Range 1" 0 "No obstacle" ;
VAL_ 688 FL_1SideAreaScand 1 "True" 0 "False" ;
VAL_ 688 FR_1SideAreaScand 1 "True" 0 "False" ;
VAL_ 688 RL_1SideAreaScand 1 "True" 0 "False" ;
VAL_ 688 RR_1SideAreaScand 1 "True" 0 "False" ;
VAL_ 688 UPC_SDW_WorkMode 3 "Failure" 2 "Active" 1 "Standby" 0 "Off" ;
VAL_ 688 APA_PSLSts 7 "Reserved" 6 "Reserved" 5 "PA Failure" 4 "APS Failure" 3 "Tracking" 2 "Searching" 1 "Standby" 0 "Off" ;
VAL_ 944 ICM_ODOTotal 16777215 "Invalid" ;
